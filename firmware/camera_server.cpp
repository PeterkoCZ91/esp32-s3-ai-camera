#include "camera_server.h"
#include "health_monitor.h"
#include "esp_http_server.h"
#include "ws_log.h"
#include "esp_camera.h"
#include "esp_timer.h"
#include "esp_task_wdt.h"
#include <WiFi.h>
#include <WiFiUdp.h>
#include "ArduinoJson.h"
#include "config.h"
#include "ir_control.h"
#include <freertos/FreeRTOS.h>
#include <freertos/semphr.h>
#ifdef INCLUDE_AUDIO
#include "audio_handler.h"
#endif
#include "motion_detection.h"
#ifdef INCLUDE_PERSON_DETECT
#include "person_detection.h"
#endif
#include "SD.h"
#include "SPI.h"
#include "FS.h"
#include <lwip/sockets.h> // Pro setsockopt (SO_SNDTIMEO)
#include "ESP32-RTSPServer.h"
#include "camera_capture.h"
#include "mbedtls/base64.h" // For Base64 decoding (HTTP Basic Auth)
#include <Update.h>          // HTTP OTA firmware update
#ifdef INCLUDE_SD_RECORDING
#include "avi_writer.h"      // AVI recording (MJPEG + PCM audio)
#endif
#include "board_config.h"    // I2S_SAMPLE_RATE

// ESP32-RTSPServer library (generic, works with any camera via esp_camera)
// #include "ESP32_RTSP.h"  // DISABLED - library not available

// Extern config from main.cpp
extern Config config;
extern bool saveConfig();
extern void saveCredentialsToNVS();
extern bool captive_portal_active;

httpd_handle_t camera_httpd = NULL;
httpd_handle_t stream_httpd = NULL;
httpd_handle_t audio_httpd = NULL;

// RTSP Server globals
RTSPServer rtspServer; // Global instance

// Recording Globals
bool is_recording = false;
File recordingFile;
SemaphoreHandle_t recordingMutex = NULL;
AviWriter aviWriter;
char lastRecordingFilename[64] = {0}; // Filled by startSDRecording, read by motionTask

// Forward declarations for recording functions
bool startSDRecording();
void stopSDRecording();

// UDP Remote Logging
WiFiUDP udpLog;
const char* RASPBERRY_PI_IP = "192.168.68.53";  // IP Raspberry Pi
const int UDP_LOG_PORT = 5000;  // Port pro UDP logging
bool udp_logging_enabled = false;  // Vypnuto (zapnout jen pro debug s Raspberry Pi)
static SemaphoreHandle_t udp_mutex = NULL; // Mutex for thread-safe logging
static SemaphoreHandle_t settings_mutex = NULL; // Mutex for thread-safe settings access

// FIXED: Odeslat log přes UDP na Raspberry Pi s error handling
void send_udp_log(const char* level, const char* message) {
    if (!udp_logging_enabled || WiFi.status() != WL_CONNECTED) {
        return;  // Skip pokud není WiFi nebo je logging vypnutý
    }

    // Mutex is created in startCameraServer(), skip if not ready yet
    if (udp_mutex == NULL) return;

    char log_message[512];  // Zvětšeno z 256 na 512 bytů
    unsigned long uptime_ms = millis();

    // Format: [ESP32][uptime][level] message
    int written = snprintf(log_message, sizeof(log_message), "[ESP32][%lu][%s] %s", uptime_ms, level, message);

    // Check buffer overflow
    if (written >= sizeof(log_message)) {
        Serial.println("⚠️ UDP log message truncated!");
        log_message[sizeof(log_message) - 1] = '\0';  // Ensure null termination
    }

    if (udp_mutex && xSemaphoreTake(udp_mutex, pdMS_TO_TICKS(10))) {
        udpLog.beginPacket(RASPBERRY_PI_IP, UDP_LOG_PORT);
        udpLog.write((const uint8_t*)log_message, strlen(log_message));

        // Check if packet was sent successfully
        if (!udpLog.endPacket()) {
            static unsigned long last_error_log = 0;
            if (millis() - last_error_log > 10000) {  // Log error max every 10s
                Serial.println("⚠️ Failed to send UDP log packet");
                last_error_log = millis();
            }
        }
        xSemaphoreGive(udp_mutex);
    }
}

// HTTP Basic Auth helper
// In LAB_MODE: always returns ESP_OK (no auth check)
// In production: validates Authorization header against config.http_user:config.http_pass
static esp_err_t check_basic_auth(httpd_req_t *req) {
#if LAB_MODE
    return ESP_OK;  // No auth in lab mode
#else
    char auth_header[256] = {0};
    esp_err_t err = httpd_req_get_hdr_value_str(req, "Authorization", auth_header, sizeof(auth_header));

    if (err != ESP_OK) {
        httpd_resp_set_status(req, "401 Unauthorized");
        httpd_resp_set_type(req, "text/plain");
        httpd_resp_set_hdr(req, "WWW-Authenticate", "Basic realm=\"ESP32-Cam\"");
        httpd_resp_send(req, "Authentication required", HTTPD_RESP_USE_STRLEN);
        return ESP_FAIL;
    }

    // Expect "Basic <base64>"
    if (strncmp(auth_header, "Basic ", 6) != 0) {
        httpd_resp_set_status(req, "401 Unauthorized");
        httpd_resp_set_type(req, "text/plain");
        httpd_resp_set_hdr(req, "WWW-Authenticate", "Basic realm=\"ESP32-Cam\"");
        httpd_resp_send(req, "Invalid auth scheme", HTTPD_RESP_USE_STRLEN);
        return ESP_FAIL;
    }

    const char* b64_creds = auth_header + 6;
    unsigned char decoded[128];
    size_t decoded_len = 0;
    int ret = mbedtls_base64_decode(decoded, sizeof(decoded) - 1, &decoded_len,
                                     (const unsigned char*)b64_creds, strlen(b64_creds));
    if (ret != 0) {
        httpd_resp_set_status(req, "401 Unauthorized");
        httpd_resp_set_type(req, "text/plain");
        httpd_resp_set_hdr(req, "WWW-Authenticate", "Basic realm=\"ESP32-Cam\"");
        httpd_resp_send(req, "Invalid credentials", HTTPD_RESP_USE_STRLEN);
        return ESP_FAIL;
    }
    decoded[decoded_len] = '\0';

    // Build expected "user:pass"
    String expected = config.http_user + ":" + config.http_pass;
    if (expected.equals((const char*)decoded)) {
        return ESP_OK;
    }

    httpd_resp_set_status(req, "401 Unauthorized");
    httpd_resp_set_type(req, "text/plain");
    httpd_resp_set_hdr(req, "WWW-Authenticate", "Basic realm=\"ESP32-Cam\"");
    httpd_resp_send(req, "Invalid credentials", HTTPD_RESP_USE_STRLEN);
    return ESP_FAIL;
#endif
}

// MJPEG stream boundary
#define PART_BOUNDARY "123456789000000000000987654321"
static const char* _STREAM_CONTENT_TYPE = "multipart/x-mixed-replace;boundary=" PART_BOUNDARY;
static const char* _STREAM_BOUNDARY = "\r\n--" PART_BOUNDARY "\r\n";
static const char* _STREAM_PART = "Content-Type: image/jpeg\r\nContent-Length: %u\r\n\r\n";

// HTML GUI — dark dashboard theme (auto-generated, do not edit manually)
// INDEX_HTML gzipped: 11645 -> 2943 bytes
const uint8_t INDEX_HTML_GZ[] PROGMEM = {
  0x1f,0x8b,0x08,0x00,0xb8,0xf6,0xd7,0x69,0x02,0xff,0xc5,0x1a,0x6b,0x77,0xda,0x38,0xf6,0x7b,0x7f,0x85,
  0xcb,0x9c,0x39,0x86,0x2d,0x06,0x03,0x81,0x50,0x07,0xe8,0x4c,0xa7,0xe9,0x6e,0xa7,0xaf,0x9c,0xa6,0xd3,
  0x39,0xb3,0x5f,0x38,0xc2,0x96,0x41,0x8d,0xb1,0x7c,0x64,0x91,0x84,0xa1,0xf9,0xef,0x7b,0x25,0x19,0x63,
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  0x2d,0x00,0x00
};
const size_t INDEX_HTML_GZ_LEN = sizeof(INDEX_HTML_GZ);

// Stranka nastaveni — dark dashboard theme
// SETTINGS_HTML gzipped: 25952 -> 5023 bytes
const uint8_t SETTINGS_HTML_GZ[] PROGMEM = {
  0x1f,0x8b,0x08,0x00,0x00,0x00,0x00,0x00,0x02,0xff,0xcd,0x3d,0x69,0x97,0xda,0x38,0xb6,0xdf,0xfb,0x57,
  0xa8,0xc9,0x49,0x03,0xdd,0x18,0x8c,0x29,0x08,0x05,0x05,0xef,0x65,0xb2,0xf4,0xa4,0xa7,0xb3,0xcc,0x24,
  0x3d,0x6f,0xa6,0xfb,0xf4,0xa9,0x23,0x6c,0x01,0x4e,0x19,0xdb,0x63,0xcb,0xd4,0x36,0xf5,0xdf,0xdf,0x95,
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  0x65,0x00,0x00
};
const size_t SETTINGS_HTML_GZ_LEN = sizeof(SETTINGS_HTML_GZ);

// Handler: Main page - HTML GUI
static esp_err_t index_handler(httpd_req_t *req) {
    httpd_resp_set_type(req, "text/html");
    httpd_resp_set_hdr(req, "Content-Encoding", "gzip");
    return httpd_resp_send(req, (const char*)INDEX_HTML_GZ, INDEX_HTML_GZ_LEN);
}

// Handler: Single JPEG frame (reads from ring buffer -- no direct esp_camera_fb_get!)
static esp_err_t frame_handler(httpd_req_t *req) {
    int idx = getLatestFrameIndex();
    if (idx < 0) {
        Serial.println("Camera frame not available yet");
        httpd_resp_send_500(req);
        return ESP_FAIL;
    }

    if (!acquireFrameReader(idx)) {
        // Writer aktivní, krátká pauza a retry
        vTaskDelay(pdMS_TO_TICKS(5));
        idx = getLatestFrameIndex();
        if (idx < 0 || !acquireFrameReader(idx)) {
            httpd_resp_send_500(req);
            return ESP_FAIL;
        }
    }

    // Validate frame data
    if (frameBuffers[idx].data == NULL || frameBuffers[idx].len == 0) {
        releaseFrameReader(idx);
        Serial.println("Ring buffer frame empty");
        httpd_resp_send_500(req);
        return ESP_FAIL;
    }

    httpd_resp_set_type(req, "image/jpeg");
    httpd_resp_set_hdr(req, "Content-Disposition", "inline; filename=capture.jpg");
    httpd_resp_set_hdr(req, "Access-Control-Allow-Origin", "*");

    esp_err_t res = httpd_resp_send(req, (const char *)frameBuffers[idx].data,
                                     frameBuffers[idx].len);

    releaseFrameReader(idx);
    return res;
}

// Global variables for client tracking (atomic for thread safety across httpd workers)
static int active_stream_clients = 0;
static int active_detection_clients = 0;
const int MAX_STREAM_CLIENTS = 2;  // Max clients pro GUI stream
const int MAX_DETECTION_CLIENTS = 2;  // Increased to allow two detection clients (e.g., a8.py and test script)

// Helper: nastavení send timeout na HTTP stream socket
static void setStreamSocketTimeout(httpd_req_t *req, int timeout_ms = 500) {
    int sockfd = httpd_req_to_sockfd(req);
    struct timeval send_timeout;
    send_timeout.tv_sec = timeout_ms / 1000;
    send_timeout.tv_usec = (timeout_ms % 1000) * 1000;
    if (setsockopt(sockfd, SOL_SOCKET, SO_SNDTIMEO, &send_timeout, sizeof(send_timeout)) < 0) {
        Serial.println("Failed to set socket send timeout");
    }
}

// Helper function to set CORS headers
static void set_cors_headers(httpd_req_t *req) {
    httpd_resp_set_hdr(req, "Access-Control-Allow-Origin", "*");
    httpd_resp_set_hdr(req, "Access-Control-Allow-Methods", "GET, POST, OPTIONS");
    httpd_resp_set_hdr(req, "Access-Control-Allow-Headers", "Content-Type, Authorization");
    httpd_resp_set_hdr(req, "Access-Control-Max-Age", "86400"); // Cache preflight for 24 hours
}

// Handler: HEAD request for streams (checks availability)
static esp_err_t stream_head_handler(httpd_req_t *req) {
    httpd_resp_set_type(req, "multipart/x-mixed-replace;boundary=" PART_BOUNDARY);
    httpd_resp_set_hdr(req, "Access-Control-Allow-Origin", "*");
    httpd_resp_set_status(req, "200 OK");
    httpd_resp_send(req, NULL, 0);
    return ESP_OK;
}

// Generic Video Stream Handler to reduce duplication
static esp_err_t generic_video_stream_handler(httpd_req_t *req, int *active_clients, int max_clients, const char* stream_name, bool limit_fps) {
    esp_err_t res = ESP_OK;
    char part_buf[64];

    // Client limit check (atomic read)
    int current_count = __atomic_load_n(active_clients, __ATOMIC_SEQ_CST);
    if (current_count >= max_clients) {
        Serial.printf("⚠️  %s: Max clients reached, rejecting new connection\n", stream_name);
        char log_msg[128];
        snprintf(log_msg, sizeof(log_msg), "%s: Max clients reached, connection rejected", stream_name);
        send_udp_log("WARN", log_msg);
        httpd_resp_set_status(req, "429 Too Many Requests");
        httpd_resp_send(req, "Too many clients connected", HTTPD_RESP_USE_STRLEN);
        return ESP_FAIL;
    }

    __atomic_fetch_add(active_clients, 1, __ATOMIC_SEQ_CST);
    current_count = __atomic_load_n(active_clients, __ATOMIC_SEQ_CST);
    Serial.printf("✅ %s connected (clients: %d/%d)\n", stream_name, current_count, max_clients);

    char connect_msg[128];
    snprintf(connect_msg, sizeof(connect_msg), "%s connected (clients: %d/%d)",
             stream_name, *active_clients, max_clients);
    send_udp_log("INFO", connect_msg);

    res = httpd_resp_set_type(req, _STREAM_CONTENT_TYPE);
    if (limit_fps) {
        set_cors_headers(req);
        httpd_resp_set_hdr(req, "X-Framerate", "30");
    } else {
        httpd_resp_set_hdr(req, "Access-Control-Allow-Origin", "*");
    }
    
    httpd_resp_set_hdr(req, "Content-Disposition", "inline; filename=stream.mjpeg");

    if(res != ESP_OK) {
        __atomic_fetch_sub(active_clients, 1, __ATOMIC_SEQ_CST);
        return res;
    }

    // Set socket send timeout
    setStreamSocketTimeout(req, 500);

    // Zero-Copy Ring Buffer Implementation
    // No local buffer allocation needed!

    unsigned long frame_count = 0;
    unsigned long my_last_timestamp = 0;

    while(true) {
        // Wait for new frame
        bool new_frame = false;
        unsigned long wait_start = millis();
        int frame_idx = -1;

        while (!new_frame) {
            // Check timeout (if no frame for 2s, abort)
            if (millis() - wait_start > 2000) {
                break;
            }
            
            // Check if new frame available in Ring Buffer (CAS-safe reader)
            int idx = getLatestFrameIndex();
            if (idx >= 0 && frameBuffers[idx].timestamp > my_last_timestamp) {
                if (acquireFrameReader(idx)) {
                    frame_idx = idx;
                    my_last_timestamp = frameBuffers[idx].timestamp;
                    new_frame = true;
                }
            }
            
            if (!new_frame) {
                vTaskDelay(5); // Wait a bit
            }
        }

        if (!new_frame) {
            Serial.println("⚠️ MJPEG: No frame from capture task");
            res = ESP_FAIL;
            break;
        }

        // Send boundary
        res = httpd_resp_send_chunk(req, _STREAM_BOUNDARY, strlen(_STREAM_BOUNDARY));
        if(res == ESP_OK) {
            // Send header with length
            size_t hlen = snprintf((char *)part_buf, 64, _STREAM_PART, frameBuffers[frame_idx].len);
            res = httpd_resp_send_chunk(req, (const char *)part_buf, hlen);
        }
        
        if(res == ESP_OK) {
            // Send frame data directly from Ring Buffer (Zero-Copy!)
            res = httpd_resp_send_chunk(req, (const char *)frameBuffers[frame_idx].data, frameBuffers[frame_idx].len);
        }

        // Release frame reader reference
        releaseFrameReader(frame_idx);

        if(res != ESP_OK) {
            Serial.println("Stream send failed (timeout or disconnect)");
            // FIXED: Force close socket on error to prevent socket leak
            // Half-open sockets can accumulate after timeouts, exhausting available sockets
            int sockfd = httpd_req_to_sockfd(req);
            if (sockfd >= 0) {
                httpd_sess_trigger_close(stream_httpd, sockfd);
            }
            break;
        }
        
        if (limit_fps) {
            // Precise timing handled by capture task, but we can yield here
            // vTaskDelay(pdMS_TO_TICKS(1));
            // Actually, for detection stream we might want to limit rate if client is slow
             vTaskDelay(pdMS_TO_TICKS(33));
        }

        // Reset WDT periodically (every 30 frames = ~1 second at 30 FPS)
        if (frame_count % 30 == 0) {
            esp_task_wdt_reset();
        }

        frame_count++;
    }
    
    __atomic_fetch_sub(active_clients, 1, __ATOMIC_SEQ_CST);
    int remaining = __atomic_load_n(active_clients, __ATOMIC_SEQ_CST);
    Serial.printf("🔌 %s disconnected (clients: %d/%d, frames: %lu)\n", stream_name, remaining, max_clients, frame_count);

    char disconnect_msg[128];
    snprintf(disconnect_msg, sizeof(disconnect_msg), "%s disconnected (clients: %d/%d, frames: %lu)",
             stream_name, remaining, max_clients, frame_count);
    send_udp_log("INFO", disconnect_msg);
    
    return res;
}

// Handler: MJPEG stream (pro GUI)
static esp_err_t stream_handler(httpd_req_t *req) {
    return generic_video_stream_handler(req, &active_stream_clients, MAX_STREAM_CLIENTS, "GUI Stream", false);
}

// Handler: Lightweight detection stream (pro Python skript)
static esp_err_t detection_stream_handler(httpd_req_t *req) {
    return generic_video_stream_handler(req, &active_detection_clients, MAX_DETECTION_CLIENTS, "Detection stream", true);
}

static esp_err_t status_handler(httpd_req_t *req) {
    // Increase buffer size to prevent truncation (person detection fields added)
    char json_response[2560];

    String ip = WiFi.localIP().toString();
    if (WiFi.getMode() == WIFI_AP) {
        ip = WiFi.softAPIP().toString();
    }

    size_t max_alloc_heap = ESP.getMaxAllocHeap();
    int total_clients = active_stream_clients + active_detection_clients;
    
    // Uptime formatting
    unsigned long uptime_sec = (unsigned long)(esp_timer_get_time() / 1000000);
    unsigned long uptime_days = uptime_sec / 86400;
    unsigned long uptime_hours = (uptime_sec % 86400) / 3600;
    unsigned long uptime_mins = (uptime_sec % 3600) / 60;
    
    // Flash info
    uint32_t flash_size = ESP.getFlashChipSize();
    uint32_t flash_used = ESP.getSketchSize();

    // Acquire settings mutex for thread-safe config read
    if (settings_mutex) {
        xSemaphoreTake(settings_mutex, pdMS_TO_TICKS(100)); // 100ms timeout
    }

    // Get IR Config for Lux reading
    IRConfig irCfg = getIRConfig();

    sensor_t * s = esp_camera_sensor_get();
    if (s != NULL) {
        snprintf(json_response, sizeof(json_response),
            "{\"ip\":\"%s\",\"uptime\":\"%lud %luh %lum\",\"uptime_seconds\":%lu,\"uptime_days\":%lu,\"uptime_hours\":%lu,"
            "\"free_heap\":%u,\"max_alloc_heap\":%u,\"free_psram\":%u,"
            "\"flash_size\":%u,\"flash_used\":%u,\"flash_usage_pct\":%.1f,"
            "\"wifi_rssi\":%d,\"clients\":%d,\"stream_clients\":%d,\"detection_clients\":%d,"
            "\"vflip\":%d,\"hmirror\":%d,\"jpeg_quality\":%d,\"frame_size\":%d,"
            "\"brightness\":%d,\"contrast\":%d,\"saturation\":%d,\"sharpness\":%d,\"denoise\":%d,"
            "\"aec\":%d,\"ae_level\":%d,\"agc\":%d,\"awb\":%d,\"ambient_light_lux\":%.2f,\"ir_led\":%d,"
            "\"motion_telegram_photo\":%d,\"motion_telegram_video\":%d,\"motion_telegram_cooldown\":%d,"
            "\"motion_notify_start_hour\":%d,\"motion_notify_end_hour\":%d,"
            "\"person_detection_enabled\":%d,\"person_confidence_threshold\":%.2f,\"person_detection_cooldown\":%d,"
            "\"person_last_inference_ms\":%lu,\"sd_total_mb\":%llu,\"sd_used_mb\":%llu,\"version\":\"%s\"}",
            ip.c_str(),
            uptime_days, uptime_hours, uptime_mins,
            uptime_sec,
            uptime_days, uptime_hours,
            ESP.getFreeHeap(), max_alloc_heap, ESP.getFreePsram(),
            flash_size, flash_used, (float)flash_used/flash_size*100,
            WiFi.RSSI(), total_clients, active_stream_clients, active_detection_clients,
            s->status.vflip, s->status.hmirror, s->status.quality, s->status.framesize,
            s->status.brightness, s->status.contrast, s->status.saturation,
            s->status.sharpness, s->status.denoise,
            s->status.aec, s->status.ae_level, s->status.agc, s->status.awb,
            irCfg.last_lux_reading, irCfg.ir_led_current_state,
            config.motion_telegram_photo ? 1 : 0,
            config.motion_telegram_video ? 1 : 0,
            config.motion_telegram_cooldown,
            config.motion_notify_start_hour,
            config.motion_notify_end_hour,
            config.person_detection_enabled ? 1 : 0,
            config.person_confidence_threshold,
            config.person_detection_cooldown,
            personDetector.getLastResult().inference_ms,
            SD.cardSize() / (1024 * 1024),
            SD.usedBytes() / (1024 * 1024),
            config.version.c_str()
        );
    } else {
        snprintf(json_response, sizeof(json_response),
            "{\"ip\":\"%s\",\"uptime\":\"%lud %luh %lum\",\"uptime_seconds\":%lu,\"uptime_days\":%lu,\"uptime_hours\":%lu,"
            "\"free_heap\":%u,\"max_alloc_heap\":%u,\"free_psram\":%u,"
            "\"flash_size\":%u,\"flash_used\":%u,"
            "\"wifi_rssi\":%d,\"clients\":%d,\"error\":\"camera_sensor_null\"}",
            ip.c_str(),
            uptime_days, uptime_hours, uptime_mins,
            uptime_sec,
            uptime_days, uptime_hours,
            ESP.getFreeHeap(), max_alloc_heap, ESP.getFreePsram(),
            flash_size, flash_used,
            WiFi.RSSI(), total_clients
        );
    }

    // Release mutex
    if (settings_mutex) {
        xSemaphoreGive(settings_mutex);
    }

    httpd_resp_set_type(req, "application/json");
    httpd_resp_set_hdr(req, "Access-Control-Allow-Origin", "*");
    httpd_resp_set_hdr(req, "Cache-Control", "no-store, no-cache, must-revalidate, max-age=0");
    httpd_resp_set_hdr(req, "Pragma", "no-cache");
    httpd_resp_set_hdr(req, "Connection", "close");
    
    return httpd_resp_send(req, json_response, HTTPD_RESP_USE_STRLEN);
}

// Handler: Settings HTML page
static esp_err_t settings_page_handler(httpd_req_t *req) {
    httpd_resp_set_type(req, "text/html");
    httpd_resp_set_hdr(req, "Content-Encoding", "gzip");
    return httpd_resp_send(req, (const char*)SETTINGS_HTML_GZ, SETTINGS_HTML_GZ_LEN);
}

// Handler: Settings page (GET) - Returns current camera settings as JSON
static esp_err_t settings_get_handler(httpd_req_t *req) {
    Serial.println("Settings GET handler called! Returning JSON.");
    
    // Acquire mutex for thread-safe config read
    if (settings_mutex) {
        xSemaphoreTake(settings_mutex, pdMS_TO_TICKS(100)); // 100ms timeout
    }

    sensor_t * s = esp_camera_sensor_get();
    // FIXED: Use StaticJsonDocument to avoid heap fragmentation
    StaticJsonDocument<1536> doc;

    if (s != NULL) {
        doc["jpeg_quality"] = s->status.quality;
        doc["frame_size"] = s->status.framesize;
        doc["vflip"] = s->status.vflip;
        doc["hmirror"] = s->status.hmirror;
        doc["brightness"] = s->status.brightness;
        doc["contrast"] = s->status.contrast;
        doc["saturation"] = s->status.saturation;
        doc["sharpness"] = s->status.sharpness;
        doc["denoise"] = s->status.denoise;
        doc["aec"] = s->status.aec;
        doc["ae_level"] = s->status.ae_level;
        doc["agc"] = s->status.agc;
        doc["awb"] = s->status.awb;
        doc["awb_gain"] = s->status.awb_gain;
        doc["wb_mode"] = s->status.wb_mode;
        doc["aec_value"] = s->status.aec_value;
        doc["gainceiling"] = s->status.gainceiling;
        doc["version"] = config.version.c_str(); // Add firmware version
    } else {
        doc["error"] = "Camera sensor unavailable";
    }

    // Motion → Telegram settings (always available, independent of camera sensor)
    doc["motion_telegram_photo"] = config.motion_telegram_photo;
    doc["motion_telegram_video"] = config.motion_telegram_video;
    doc["motion_telegram_cooldown"] = config.motion_telegram_cooldown;
    doc["motion_notify_start_hour"] = config.motion_notify_start_hour;
    doc["motion_notify_end_hour"] = config.motion_notify_end_hour;

    // Person Detection (AI FOMO) settings
    doc["person_detection_enabled"] = config.person_detection_enabled;
    doc["person_confidence_threshold"] = config.person_confidence_threshold;
    doc["person_detection_cooldown"] = config.person_detection_cooldown;

    // SD Card auto-recording settings
    doc["sd_auto_record"] = config.sd_auto_record;
    doc["sd_auto_record_duration"] = config.sd_auto_record_duration;
    doc["sd_max_usage_percent"] = config.sd_max_usage_percent;
    doc["sd_record_fps"] = config.sd_record_fps;

    // MQTT settings
    doc["mqtt_enabled"] = config.mqtt_enabled;
    doc["mqtt_server"] = config.mqtt_server;
    doc["mqtt_port"] = config.mqtt_port;

    // Release mutex
    if (settings_mutex) {
        xSemaphoreGive(settings_mutex);
    }

    String response;
    serializeJson(doc, response);

    httpd_resp_set_type(req, "application/json");
    httpd_resp_set_hdr(req, "Access-Control-Allow-Origin", "*");
    return httpd_resp_sendstr(req, response.c_str());
}

// Handler: Settings update (POST)
static esp_err_t settings_post_handler(httpd_req_t *req) {
    if (check_basic_auth(req) != ESP_OK) return ESP_FAIL;

    Serial.println("Settings POST handler called!");

    // Allocate buffer on heap to save stack
    char* buf = (char*)malloc(1024);
    if (!buf) {
        Serial.println("ERROR: Failed to allocate buffer");
        httpd_resp_send_500(req);
        return ESP_FAIL;
    }
    
    int ret, remaining = req->content_len;

    Serial.printf("Content length: %d bytes\n", remaining);

    // Buffer overflow protection
    if (remaining >= 1024) {
        Serial.println("ERROR: Request too large!");
        free(buf);
        httpd_resp_send_500(req);
        return ESP_FAIL;
    }

    ret = httpd_req_recv(req, buf, remaining);
    if (ret <= 0) {
        Serial.printf("ERROR: Failed to receive data, ret=%d\n", ret);
        if (ret == HTTPD_SOCK_ERR_TIMEOUT) {
            httpd_resp_send_408(req);
        }
        free(buf);
        return ESP_FAIL;
    }
    buf[ret] = '\0';

    Serial.printf("Received JSON: %s\n", buf);

    // Acquire mutex before parsing and applying settings
    if (settings_mutex && xSemaphoreTake(settings_mutex, portMAX_DELAY) != pdTRUE) {
        Serial.println("ERROR: Failed to acquire settings mutex");
        free(buf);
        httpd_resp_send_500(req);
        return ESP_FAIL;
    }

    // FIXED: Use StaticJsonDocument to avoid heap fragmentation
    StaticJsonDocument<2048> doc;
    // Cast to const char* to force copy (safer than Zero-Copy with mutable buffer)
    DeserializationError error = deserializeJson(doc, (const char*)buf);
    
    if (error) {
        Serial.printf("ERROR: JSON parse failed: %s\n", error.c_str());
        httpd_resp_set_status(req, "400 Bad Request");
        httpd_resp_set_type(req, "application/json");
        httpd_resp_send(req, "{\"success\":false,\"message\":\"Invalid JSON\"}", HTTPD_RESP_USE_STRLEN);
        xSemaphoreGive(settings_mutex);
        free(buf); // Free memory before return
        return ESP_OK;
    }

    // Reset watchdog before potentially blocking operations
    esp_task_wdt_reset(); // Keep WDT happy during stream processing
    
    // Apply settings
    sensor_t * s = esp_camera_sensor_get();
    if (s == NULL) {
        Serial.println("ERROR: Camera sensor is NULL! Cannot apply settings.");
        httpd_resp_set_status(req, "500 Internal Server Error");
        httpd_resp_set_type(req, "application/json");
        httpd_resp_send(req, "{\"success\":false,\"message\":\"Camera sensor unavailable\"}", HTTPD_RESP_USE_STRLEN);
        xSemaphoreGive(settings_mutex);
        free(buf); // Free memory before return
        return ESP_OK;
    }
    
    // Sensor is valid, proceed with settings
    Serial.println("Applying settings to camera sensor...");
        if (doc.containsKey("jpeg_quality")) {
            int quality = constrain((int)doc["jpeg_quality"], 5, 63);
            if (s->status.quality != quality) {
                s->set_quality(s, quality);
                config.jpeg_quality = quality;
            }
        }
        bool needs_reboot = false;
        if (doc.containsKey("frame_size")) {
            int framesize = doc["frame_size"];
            if (s->status.framesize != framesize) {
                // Framesize change requires DMA reconfig — save and reboot
                config.frame_size = framesize;
                needs_reboot = true;
            }
        }
        if (doc.containsKey("vflip")) {
            int vflip = doc["vflip"] ? 1 : 0;
            if (s->status.vflip != vflip) {
                s->set_vflip(s, vflip);
                config.flip_vertical = vflip;
            }
        }
        if (doc.containsKey("hmirror")) {
            int hmirror = doc["hmirror"] ? 1 : 0;
            if (s->status.hmirror != hmirror) {
                s->set_hmirror(s, hmirror);
                config.flip_horizontal = hmirror;
            }
        }
        // Obraz
        if (doc.containsKey("brightness")) {
            int val = doc["brightness"];
            if (s->status.brightness != val) s->set_brightness(s, val);
        }
        if (doc.containsKey("contrast")) {
            int val = doc["contrast"];
            if (s->status.contrast != val) s->set_contrast(s, val);
        }
        if (doc.containsKey("saturation")) {
            int val = doc["saturation"];
            if (s->status.saturation != val) s->set_saturation(s, val);
        }
        if (doc.containsKey("sharpness")) {
            int val = doc["sharpness"];
            if (s->status.sharpness != val) s->set_sharpness(s, val);
        }
        if (doc.containsKey("denoise")) {
            int val = doc["denoise"];
            if (s->status.denoise != val) s->set_denoise(s, val);
        }
        
        // Auto kontroly (use .as<int>() to correctly parse 0/1, not JsonVariant truthiness)
        if (doc.containsKey("aec")) {
            int val = doc["aec"].as<int>() ? 1 : 0;
            if (s->status.aec != val) s->set_exposure_ctrl(s, val);
        }
        if (doc.containsKey("aec2")) {
            int val = doc["aec2"].as<int>() ? 1 : 0;
            s->set_aec2(s, val);
        }
        if (doc.containsKey("ae_level")) {
            int val = doc["ae_level"];
            if (s->status.ae_level != val) s->set_ae_level(s, val);
        }
        if (doc.containsKey("agc")) {
            int val = doc["agc"].as<int>() ? 1 : 0;
            if (s->status.agc != val) s->set_gain_ctrl(s, val);
        }
        if (doc.containsKey("agc_gain")) {
            int val = doc["agc_gain"];
            if (s->status.agc_gain != val) s->set_agc_gain(s, val);
        }
        if (doc.containsKey("awb")) {
            int val = doc["awb"].as<int>() ? 1 : 0;
            if (s->status.awb != val) s->set_whitebal(s, val);
        }
        if (doc.containsKey("awb_gain")) {
            int val = doc["awb_gain"].as<int>() ? 1 : 0;
            if (s->status.awb_gain != val) s->set_awb_gain(s, val);
        }
        if (doc.containsKey("wb_mode")) {
            int val = doc["wb_mode"];
            if (s->status.wb_mode != val) s->set_wb_mode(s, val);
        }
        if (doc.containsKey("aec_value")) {
            int val = doc["aec_value"];
            if (s->status.aec_value != val) s->set_aec_value(s, val);
        }
        if (doc.containsKey("gainceiling")) {
            int val = doc["gainceiling"];
            if (s->status.gainceiling != val) s->set_gainceiling(s, (gainceiling_t)val);
        }

        // Motion → Telegram settings
        bool config_changed = false;
        if (doc.containsKey("motion_telegram_photo")) {
            bool val = doc["motion_telegram_photo"];
            if (config.motion_telegram_photo != val) {
                config.motion_telegram_photo = val;
                config_changed = true;
                Serial.printf("📷 Motion→Telegram foto: %s\n", val ? "ON" : "OFF");
            }
        }
        if (doc.containsKey("motion_telegram_video")) {
            bool val = doc["motion_telegram_video"];
            if (config.motion_telegram_video != val) {
                config.motion_telegram_video = val;
                config_changed = true;
                Serial.printf("🎬 Motion→Telegram video: %s\n", val ? "ON" : "OFF");
            }
        }
        if (doc.containsKey("motion_telegram_cooldown")) {
            int val = doc["motion_telegram_cooldown"];
            if (val >= 5 && val <= 3600 && config.motion_telegram_cooldown != val) {
                config.motion_telegram_cooldown = val;
                config_changed = true;
                Serial.printf("📷 Motion→Telegram cooldown: %ds\n", val);
            }
        }
        if (doc.containsKey("motion_notify_start_hour")) {
            int val = doc["motion_notify_start_hour"];
            if (val >= 0 && val <= 23 && config.motion_notify_start_hour != val) {
                config.motion_notify_start_hour = val;
                config_changed = true;
            }
        }
        if (doc.containsKey("motion_notify_end_hour")) {
            int val = doc["motion_notify_end_hour"];
            if (val >= 0 && val <= 23 && config.motion_notify_end_hour != val) {
                config.motion_notify_end_hour = val;
                config_changed = true;
            }
        }

        // Person Detection (AI FOMO) settings
        if (doc.containsKey("person_detection_enabled")) {
            bool val = doc["person_detection_enabled"];
            if (config.person_detection_enabled != val) {
                config.person_detection_enabled = val;
                config_changed = true;
                Serial.printf("🧠 Person detection: %s\n", val ? "ON" : "OFF");
            }
        }
        if (doc.containsKey("person_confidence_threshold")) {
            float val = doc["person_confidence_threshold"];
            if (val >= 0.1f && val <= 0.99f && config.person_confidence_threshold != val) {
                config.person_confidence_threshold = val;
                config_changed = true;
                Serial.printf("🧠 Person confidence threshold: %.0f%%\n", val * 100);
            }
        }
        if (doc.containsKey("person_detection_cooldown")) {
            int val = doc["person_detection_cooldown"];
            if (val >= 10 && val <= 3600 && config.person_detection_cooldown != val) {
                config.person_detection_cooldown = val;
                config_changed = true;
                Serial.printf("🧠 Person detection cooldown: %ds\n", val);
            }
        }

        // MQTT settings (non-credential parts)
        if (doc.containsKey("mqtt_enabled")) {
            bool val = doc["mqtt_enabled"];
            if (config.mqtt_enabled != val) {
                config.mqtt_enabled = val;
                config_changed = true;
                Serial.printf("MQTT: %s\n", val ? "ON" : "OFF");
            }
        }
        if (doc.containsKey("mqtt_server")) {
            String val = doc["mqtt_server"].as<String>();
            if (config.mqtt_server != val) {
                config.mqtt_server = val;
                config_changed = true;
            }
        }
        if (doc.containsKey("mqtt_port")) {
            int val = doc["mqtt_port"];
            if (val > 0 && val <= 65535 && config.mqtt_port != val) {
                config.mqtt_port = val;
                config_changed = true;
            }
        }

        // SD Card auto-recording settings
        if (doc.containsKey("sd_auto_record")) {
            bool val = doc["sd_auto_record"];
            if (config.sd_auto_record != val) {
                config.sd_auto_record = val;
                config_changed = true;
                Serial.printf("💾 SD auto-record: %s\n", val ? "ON" : "OFF");
            }
        }
        if (doc.containsKey("sd_auto_record_duration")) {
            int val = doc["sd_auto_record_duration"];
            if (val >= 5 && val <= 300 && config.sd_auto_record_duration != val) {
                config.sd_auto_record_duration = val;
                config_changed = true;
            }
        }
        if (doc.containsKey("sd_max_usage_percent")) {
            int val = doc["sd_max_usage_percent"];
            if (val >= 50 && val <= 99 && config.sd_max_usage_percent != val) {
                config.sd_max_usage_percent = val;
                config_changed = true;
            }
        }
        if (doc.containsKey("sd_record_fps")) {
            int val = doc["sd_record_fps"];
            if (val >= 1 && val <= 30 && config.sd_record_fps != val) {
                config.sd_record_fps = val;
                config_changed = true;
            }
        }

        if (config_changed) {
            saveConfig();
        }

        Serial.println("✅ Settings applied successfully!");

    httpd_resp_set_status(req, "200 OK");
    httpd_resp_set_type(req, "application/json");
    httpd_resp_set_hdr(req, "Access-Control-Allow-Origin", "*");
    httpd_resp_set_hdr(req, "Connection", "close");
    if (needs_reboot) {
        httpd_resp_send(req, "{\"success\":true,\"message\":\"Settings updated. Resolution change requires reboot.\",\"needs_reboot\":true}", HTTPD_RESP_USE_STRLEN);
    } else {
        httpd_resp_send(req, "{\"success\":true,\"message\":\"Settings updated\"}", HTTPD_RESP_USE_STRLEN);
    }
    
    // Release mutex
    if (settings_mutex) xSemaphoreGive(settings_mutex);
    
    free(buf); // Free memory at the end

    if (needs_reboot) {
        saveConfig();  // Persist new framesize before reboot
        Serial.println("🔄 Framesize changed, auto-rebooting in 2s...");
        vTaskDelay(pdMS_TO_TICKS(2000));
        ESP.restart();
    }

    return ESP_OK;
}



// Handler for OPTIONS requests (CORS preflight)
static esp_err_t options_handler(httpd_req_t *req) {
    set_cors_headers(req);
    httpd_resp_set_status(req, "204 No Content"); // No content, just headers
    httpd_resp_send(req, NULL, 0);
    return ESP_OK;
}

// IR Status handler - GET /ir-status
// Audio Status handler - GET /audio-status
static esp_err_t audio_status_handler(httpd_req_t *req) {
    set_cors_headers(req);
    httpd_resp_set_type(req, "application/json");

    char json[256];
    snprintf(json, sizeof(json),
             "{\"enabled\":%s,\"level\":%.1f,\"threshold\":%.1f,\"detected\":%s,\"sample_rate\":%d}",
             audio_enabled ? "true" : "false",
             current_audio_level,
             AUDIO_THRESHOLD_DB,
             (current_audio_level > AUDIO_THRESHOLD_DB) ? "true" : "false",
             I2S_SAMPLE_RATE);

    httpd_resp_send(req, json, strlen(json));
    return ESP_OK;
}

static esp_err_t stream_stats_handler(httpd_req_t *req) {
    set_cors_headers(req);
    httpd_resp_set_type(req, "application/json");

    // Acquire mutex for thread-safe read
    if (settings_mutex) {
        xSemaphoreTake(settings_mutex, pdMS_TO_TICKS(50));
    }

    sensor_t * s = esp_camera_sensor_get();
    int frame_size = s ? s->status.framesize : 0;
    int jpeg_quality = s ? s->status.quality : 0;

    char json[1024];
    snprintf(json, sizeof(json),
             "{\"max_stream_clients\":%d,\"max_detection_clients\":%d,"
             "\"active_stream_clients\":%d,\"active_detection_clients\":%d,"
             "\"total_clients\":%d,\"stream_fps\":%d,\"frame_size\":%d,"
             "\"jpeg_quality\":%d}",
             MAX_STREAM_CLIENTS,
             MAX_DETECTION_CLIENTS,
             active_stream_clients,
             active_detection_clients,
             active_stream_clients + active_detection_clients,
             15,  // Approximate FPS
             frame_size,
             jpeg_quality);

    // Release mutex
    if (settings_mutex) {
        xSemaphoreGive(settings_mutex);
    }

    httpd_resp_send(req, json, strlen(json));
    return ESP_OK;
}

// Motion Status handler - GET /motion-status
static esp_err_t motion_status_handler(httpd_req_t *req) {
    set_cors_headers(req);
    httpd_resp_set_type(req, "application/json");

    char json[128];
    snprintf(json, sizeof(json),
             "{\"motion_detected\":%s,\"score\":%d}",
             motionDetector.isMotionDetected() ? "true" : "false",
             motionDetector.getMotionScore());

    httpd_resp_send(req, json, strlen(json));
    return ESP_OK;
}

// ROI Mask handler - GET returns mask as "1100..." string, POST sets it
static esp_err_t roi_mask_get_handler(httpd_req_t *req) {
    set_cors_headers(req);
    httpd_resp_set_type(req, "application/json");

    int gw = motionDetector.getGridW();
    int gh = motionDetector.getGridH();

    // Build JSON: {"w":20,"h":15,"mask":"111011..."}
    String json = "{\"w\":" + String(gw) + ",\"h\":" + String(gh) + ",\"mask\":\"";
    for (int y = 0; y < gh; y++) {
        for (int x = 0; x < gw; x++) {
            json += motionDetector.getBlockMask(x, y) ? '1' : '0';
        }
    }
    json += "\"}";

    httpd_resp_send(req, json.c_str(), json.length());
    return ESP_OK;
}

static esp_err_t roi_mask_post_handler(httpd_req_t *req) {
    if (check_basic_auth(req) != ESP_OK) return ESP_FAIL;
    set_cors_headers(req);

    char content[512];
    size_t recv_size = (req->content_len < sizeof(content) - 1) ? req->content_len : sizeof(content) - 1;
    int ret = httpd_req_recv(req, content, recv_size);
    if (ret <= 0) { httpd_resp_send_408(req); return ESP_FAIL; }
    content[ret] = '\0';

    StaticJsonDocument<512> doc;
    if (deserializeJson(doc, content)) {
        httpd_resp_send(req, "{\"error\":\"Invalid JSON\"}", HTTPD_RESP_USE_STRLEN);
        return ESP_FAIL;
    }

    // Accept: {"mask":"111011..."} or {"clear":true}
    if (doc.containsKey("clear")) {
        motionDetector.clearMask();
        httpd_resp_send(req, "{\"ok\":true,\"action\":\"cleared\"}", HTTPD_RESP_USE_STRLEN);
        return ESP_OK;
    }

    const char* mask = doc["mask"];
    if (mask) {
        int gw = motionDetector.getGridW();
        int gh = motionDetector.getGridH();
        int len = strlen(mask);
        int i = 0;
        for (int y = 0; y < gh && i < len; y++) {
            for (int x = 0; x < gw && i < len; x++, i++) {
                motionDetector.setBlockMask(x, y, mask[i] != '0');
            }
        }
        int masked = 0;
        for (int j = 0; j < len; j++) if (mask[j] == '0') masked++;
        Serial.printf("ROI mask set: %d blocks masked out of %d\n", masked, gw * gh);
        httpd_resp_set_type(req, "application/json");
        char resp[64];
        snprintf(resp, sizeof(resp), "{\"ok\":true,\"masked\":%d,\"total\":%d}", masked, gw * gh);
        httpd_resp_send(req, resp, HTTPD_RESP_USE_STRLEN);
        return ESP_OK;
    }

    httpd_resp_send(req, "{\"error\":\"need mask or clear\"}", HTTPD_RESP_USE_STRLEN);
    return ESP_FAIL;
}

// Motion Debug Endpoint -- returns full motion detection state + per-block motion grid
static esp_err_t motion_debug_handler(httpd_req_t *req) {
    set_cors_headers(req);
    httpd_resp_set_type(req, "application/json");

    int gw = motionDetector.getGridW();
    int gh = motionDetector.getGridH();

    // Build JSON response with motion state + block grid
    // Buffer: 2 grids of up to 64*48=3072 chars each + JSON overhead
    char* buf = (char*)malloc(8192);
    if (!buf) {
        httpd_resp_send_500(req);
        return ESP_FAIL;
    }

    int len = snprintf(buf, 8192,
        "{\"detected\":%s,\"pct\":%.1f,\"score\":%d,\"brightness\":%d,"
        "\"threshold\":%d,\"night\":%s,"
        "\"grid_w\":%d,\"grid_h\":%d,\"motion\":\"",
        motionDetector.isMotionDetected() ? "true" : "false",
        motionDetector.getMotionPercent(),
        motionDetector.getMotionScore(),
        motionDetector.getAvgBrightness(),
        motionDetector.getEffectivePixelThreshold(),
        motionDetector.getAvgBrightness() < MOTION_NIGHT_BRIGHTNESS ? "true" : "false",
        gw, gh
    );

    // Append block motion grid as "010010..." string
    for (int y = 0; y < gh && len < 8000; y++) {
        for (int x = 0; x < gw && len < 8000; x++) {
            buf[len++] = motionDetector.getBlockMotion(x, y) ? '1' : '0';
        }
    }

    // Append ROI mask
    len += snprintf(buf + len, 8192 - len, "\",\"mask\":\"");
    for (int y = 0; y < gh && len < 8000; y++) {
        for (int x = 0; x < gw && len < 8000; x++) {
            buf[len++] = motionDetector.getBlockMask(x, y) ? '1' : '0';
        }
    }
    len += snprintf(buf + len, 8192 - len, "\"}");

    httpd_resp_send(req, buf, len);
    free(buf);
    return ESP_OK;
}

static esp_err_t ir_status_handler(httpd_req_t *req) {
    set_cors_headers(req);
    httpd_resp_set_type(req, "application/json");

    String jsonStatus = getIRStatusJSON();
    httpd_resp_send(req, jsonStatus.c_str(), jsonStatus.length());

    return ESP_OK;
}

// IR Control handler - POST /ir-control
static esp_err_t ir_control_handler(httpd_req_t *req) {
    if (check_basic_auth(req) != ESP_OK) return ESP_FAIL;

    set_cors_headers(req);

    // Read POST body
    char content[256];
    size_t recv_size = (req->content_len < sizeof(content) - 1) ? req->content_len : sizeof(content) - 1;

    int ret = httpd_req_recv(req, content, recv_size);
    if (ret <= 0) {
        if (ret == HTTPD_SOCK_ERR_TIMEOUT) {
            httpd_resp_send_408(req);
        }
        return ESP_FAIL;
    }
    content[ret] = '\0';

    // Parse JSON
    StaticJsonDocument<256> doc;
    DeserializationError error = deserializeJson(doc, content);

    if (error) {
        httpd_resp_set_status(req, "400 Bad Request");
        httpd_resp_send(req, "{\"error\":\"Invalid JSON\"}", HTTPD_RESP_USE_STRLEN);
        return ESP_FAIL;
    }

    // Get current config
    IRConfig irConfig = getIRConfig();

    // Update configuration
    if (doc.containsKey("state")) {
        String state = doc["state"].as<String>();
        if (state == "on") {
            irConfig.auto_mode = false;
            irConfig.manual_state = true;
        } else if (state == "off") {
            irConfig.auto_mode = false;
            irConfig.manual_state = false;
        } else if (state == "auto") {
            irConfig.auto_mode = true;
        }
    }

    if (doc.containsKey("threshold")) {
        float threshold = doc["threshold"];
        if (threshold >= MIN_LUX_THRESHOLD && threshold <= MAX_LUX_THRESHOLD) {
            irConfig.lux_threshold = threshold;
        }
    }

    if (doc.containsKey("auto_mode")) {
        irConfig.auto_mode = doc["auto_mode"];
    }

    if (doc.containsKey("time_based")) {
        irConfig.time_based = doc["time_based"];
    }

    if (doc.containsKey("night_start_hour")) {
        int hour = doc["night_start_hour"];
        if (hour >= 0 && hour < 24) {
            irConfig.night_start_hour = hour;
        }
    }

    if (doc.containsKey("night_end_hour")) {
        int hour = doc["night_end_hour"];
        if (hour >= 0 && hour < 24) {
            irConfig.night_end_hour = hour;
        }
    }
    
    if (doc.containsKey("lux_threshold")) {
        float threshold = doc["lux_threshold"];
        if (threshold >= 0) {
            irConfig.lux_threshold = threshold;
        }
    }

    // Apply new configuration
    setIRConfig(irConfig);

    // Return success with updated status
    httpd_resp_set_type(req, "application/json");
    String jsonStatus = getIRStatusJSON();
    httpd_resp_send(req, jsonStatus.c_str(), jsonStatus.length());

    return ESP_OK;
}

// RTSP Server Task - REMOVED (Library handles its own task)
// void rtspServerTask(void *parameter) { ... }

// Recording Task — AVI with interleaved MJPEG video + PCM16 audio
void recordingTask(void *parameter) {
    Serial.println("💾 Recording task started (AVI mode)");
    unsigned long my_last_timestamp = 0;
    unsigned long frame_write_count = 0;
    unsigned long lastFrameTime = 0;
    unsigned long recordingStartTime = 0;

    // Audio buffer on stack: 100ms of PCM16 mono @ 16kHz = 1600 samples = 3200 bytes
    const size_t AUDIO_SAMPLES_PER_FRAME = I2S_SAMPLE_RATE / 10; // 1600 at 16kHz/10fps
    int16_t audioBuf[AUDIO_SAMPLES_PER_FRAME];

    // PSRAM copy buffer: copy frame from ring buffer immediately, release slot,
    // then do slow SD write + I2S read from copy (prevents ring buffer starvation)
    uint8_t* frameCopy = (uint8_t*)ps_malloc(FRAME_BUFFER_SLOT_SIZE);
    if (!frameCopy) {
        Serial.println("❌ Recording task: failed to allocate PSRAM copy buffer!");
        vTaskDelete(NULL);
        return;
    }

    while(true) {
        if (is_recording) {

            // Frame decimation: only record at configured fps
            unsigned long now = millis();
            unsigned long frameInterval = 1000 / config.sd_record_fps;
            if (now - lastFrameTime < frameInterval) {
                vTaskDelay(pdMS_TO_TICKS(5));
                continue;
            }

            // Track recording start for auto-stop
            if (frame_write_count == 0) {
                recordingStartTime = now;
            }

            // Auto-stop: 45MB file size or 120s duration
            if (recordingFile) {
                size_t fileSize = recordingFile.position();
                if (fileSize > 45 * 1024 * 1024 || (now - recordingStartTime > 120000)) {
                    Serial.printf("💾 AVI auto-stop: %uKB, %lus\n",
                        (unsigned)(fileSize / 1024), (now - recordingStartTime) / 1000);
                    is_recording = false;
                    aviWriter.end();
                    recordingFile.close();
                    Serial.printf("💾 AVI finalized: %u video, %u audio chunks\n",
                        aviWriter.getVideoFrames(), aviWriter.getAudioChunks());
                    frame_write_count = 0;
                    continue;
                }
            }

            // Check for new frame in Ring Buffer — FAST copy-and-release
            size_t copiedLen = 0;
            if (current_frame_index >= 0) {
                int idx = current_frame_index;
                if (frameBuffers[idx].timestamp > my_last_timestamp) {
                    int rc = __atomic_load_n(&frameBuffers[idx].ref_count, __ATOMIC_SEQ_CST);
                    if (rc >= 0) {
                        __atomic_fetch_add(&frameBuffers[idx].ref_count, 1, __ATOMIC_SEQ_CST);

                        // FAST: Copy frame data and release ring buffer immediately
                        copiedLen = frameBuffers[idx].len;
                        if (copiedLen <= FRAME_BUFFER_SLOT_SIZE) {
                            memcpy(frameCopy, frameBuffers[idx].data, copiedLen);
                        } else {
                            copiedLen = 0; // Too large, skip
                        }
                        my_last_timestamp = frameBuffers[idx].timestamp;

                        __atomic_fetch_sub(&frameBuffers[idx].ref_count, 1, __ATOMIC_SEQ_CST);
                        // Ring buffer slot is now FREE for captureTask
                    }
                }
            }

            // SLOW: Write to SD + read audio (ring buffer already released)
            if (copiedLen > 0 && recordingFile) {
                if (!aviWriter.writeVideoFrame(frameCopy, copiedLen)) {
                    Serial.println("❌ AVI video write error!");
                }
                frame_write_count++;
                lastFrameTime = now;

                // Read and write interleaved audio chunk
                i2s_chan_handle_t rxh = getI2SRxHandle();
                if (rxh != NULL) {
                    size_t bytes_read = 0;
                    esp_err_t err = i2s_channel_read(rxh, audioBuf,
                        AUDIO_SAMPLES_PER_FRAME * sizeof(int16_t),
                        &bytes_read, pdMS_TO_TICKS(50));
                    if (err == ESP_OK && bytes_read > 0) {
                        aviWriter.writeAudioChunk(audioBuf, bytes_read);
                    }
                }
            }

            vTaskDelay(pdMS_TO_TICKS(5)); // Check frequently when recording
        } else {
            frame_write_count = 0;
            vTaskDelay(pdMS_TO_TICKS(500)); // Sleep if not recording
        }
    }
}

// Record Handler - POST /record {"action": "start"|"stop"}
static esp_err_t record_handler(httpd_req_t *req) {
    if (check_basic_auth(req) != ESP_OK) return ESP_FAIL;

    char content[100];
    size_t recv_size = (req->content_len < sizeof(content) - 1) ? req->content_len : sizeof(content) - 1;
    
    int ret = httpd_req_recv(req, content, recv_size);
    if (ret <= 0) {
        if (ret == HTTPD_SOCK_ERR_TIMEOUT) httpd_resp_send_408(req);
        return ESP_FAIL;
    }
    content[ret] = '\0';
    
    StaticJsonDocument<200> doc;
    DeserializationError error = deserializeJson(doc, content);
    
    if (error) {
        httpd_resp_send_500(req);
        return ESP_FAIL;
    }
    
    const char* action = doc["action"];
    String msg = "";

    if (strcmp(action, "start") == 0) {
        if (is_recording) {
            msg = "Already recording";
        } else if (!SD.cardSize()) {
            msg = "No SD card";
        } else {
            // startSDRecording handles its own mutex
            if (startSDRecording()) {
                msg = String("Recording started: ") + lastRecordingFilename;
            } else {
                msg = "Failed to start recording";
            }
        }
    } else if (strcmp(action, "stop") == 0) {
        if (is_recording) {
            // stopSDRecording handles its own mutex
            stopSDRecording();
            msg = "Recording stopped";
        } else {
            msg = "Not recording";
        }
    } else {
        msg = "Invalid action";
    }
    
    httpd_resp_set_type(req, "application/json");
    String json = "{\"status\":\"" + msg + "\",\"recording\":" + (is_recording ? "true" : "false") + "}";
    httpd_resp_sendstr(req, json.c_str());
    return ESP_OK;
}

// Telemetry Handler - GET /telemetry
static esp_err_t telemetry_handler(httpd_req_t *req) {
    httpd_resp_set_type(req, "application/json");
    httpd_resp_set_hdr(req, "Access-Control-Allow-Origin", "*");
    
    // FIXED: Use StaticJsonDocument to avoid heap fragmentation
    StaticJsonDocument<1024> doc;
    
    // System
    doc["uptime_seconds"] = millis() / 1000;
    doc["free_heap"] = ESP.getFreeHeap();
    doc["min_free_heap"] = ESP.getMinFreeHeap();
    doc["free_psram"] = ESP.getFreePsram();
    doc["cpu_freq_mhz"] = ESP.getCpuFreqMHz();
    
    // WiFi
    doc["wifi_rssi"] = WiFi.RSSI();
    doc["wifi_ip"] = WiFi.localIP().toString();
    doc["wifi_mac"] = WiFi.macAddress();
    doc["wifi_reconnects"] = wifi_health.reconnect_count;
    
    // Camera
    sensor_t * s = esp_camera_sensor_get();
    if (s) {
        doc["cam_width"] = s->status.framesize; // Need to map to pixels if needed
        doc["cam_quality"] = s->status.quality;
        doc["cam_fps_target"] = 30; // Hardcoded target
    }
    
    // Storage (SD Card)
    if(SD.cardSize()) {
        doc["sd_total_mb"] = SD.cardSize() / (1024 * 1024);
        doc["sd_used_mb"] = SD.usedBytes() / (1024 * 1024);
    } else {
        doc["sd_status"] = "not_mounted";
    }
    
    // Audio
    doc["audio_enabled"] = audio_enabled;
    doc["audio_level"] = current_audio_level;
    
    String response;
    serializeJson(doc, response);
    httpd_resp_sendstr(req, response.c_str());
    return ESP_OK;
}

static esp_err_t save_frame_handler(httpd_req_t *req) {
    if (check_basic_auth(req) != ESP_OK) return ESP_FAIL;

    // Check if SD card is mounted
    if(!SD.cardSize()) {
        httpd_resp_send_500(req);
        return ESP_FAIL;
    }

    // Allocate buffer for filename
    char filepath[64];
    time_t now;
    struct tm timeinfo;
    time(&now);
    localtime_r(&now, &timeinfo);
    
    // Create filename based on timestamp
    // Note: If NTP is not synced, time will be from boot
    strftime(filepath, sizeof(filepath), "/%Y%m%d_%H%M%S.jpg", &timeinfo);
    
    // Check content length (limit to 500KB to be safe)
    if (req->content_len > 500 * 1024) {
        Serial.println("Frame too large");
        httpd_resp_send_500(req);
        return ESP_FAIL;
    }
    
    // Allocate buffer
    char *buf = (char *)malloc(req->content_len);
    if (!buf) {
        Serial.println("Failed to allocate buffer");
        httpd_resp_send_500(req);
        return ESP_FAIL;
    }
    
    // Receive data with retry limit
    int ret = 0;
    int remaining = req->content_len;
    int timeout_retries = 0;
    const int MAX_TIMEOUT_RETRIES = 10;
    while (remaining > 0) {
        int recved = httpd_req_recv(req, buf + ret, remaining);
        if (recved <= 0) {
            if (recved == HTTPD_SOCK_ERR_TIMEOUT) {
                timeout_retries++;
                if (timeout_retries >= MAX_TIMEOUT_RETRIES) {
                    Serial.println("❌ save_frame: Too many timeouts");
                    free(buf);
                    return ESP_FAIL;
                }
                continue;
            }
            free(buf);
            return ESP_FAIL;
        }
        timeout_retries = 0;  // Reset on successful read
        ret += recved;
        remaining -= recved;
    }
    
    // Write to SD card
    File file = SD.open(filepath, FILE_WRITE);
    if (!file) {
        Serial.println("Failed to open file for writing");
        free(buf);
        httpd_resp_send_500(req);
        return ESP_FAIL;
    }
    
    file.write((uint8_t*)buf, req->content_len);
    file.close();
    free(buf);
    
    Serial.printf("Saved frame to %s\n", filepath);
    httpd_resp_send(req, "Frame saved", HTTPD_RESP_USE_STRLEN);
    return ESP_OK;
}

// --- SD Card Auto-Recording Helpers ---
// Called from motionTask (camera_capture.cpp) to start/stop auto-recording

bool startSDRecording() {
    if (!SD.cardSize()) return false;
    if (!recordingMutex) return false;

    if (xSemaphoreTake(recordingMutex, pdMS_TO_TICKS(500)) != pdTRUE) return false;

    if (is_recording) {
        xSemaphoreGive(recordingMutex);
        return true; // Already recording
    }

    // Storage rotation: delete oldest files if SD is too full
    uint64_t total = SD.totalBytes();
    uint64_t used = SD.usedBytes();
    if (total > 0) {
        int usage_pct = (int)(used * 100 / total);
        if (usage_pct >= config.sd_max_usage_percent) {
            Serial.printf("💾 SD usage %d%% >= %d%%, rotating oldest files...\n",
                          usage_pct, config.sd_max_usage_percent);
            // Find and delete oldest file (by name — files use timestamps)
            int rotated = 0;
            while (usage_pct >= config.sd_max_usage_percent - 5 && rotated < 20) {
                File root = SD.open("/");
                if (!root) break;
                String oldest_name = "";
                File entry = root.openNextFile();
                while (entry) {
                    if (!entry.isDirectory()) {
                        String name = "/" + String(entry.name());
                        if (oldest_name.isEmpty() || name < oldest_name) {
                            oldest_name = name;
                        }
                    }
                    entry.close();
                    entry = root.openNextFile();
                }
                root.close();
                if (oldest_name.isEmpty()) break;
                size_t fsize = 0;
                File f = SD.open(oldest_name);
                if (f) { fsize = f.size(); f.close(); }
                if (SD.remove(oldest_name.c_str())) {
                    rotated++;
                    Serial.printf("  🗑️ Rotated: %s (%u KB)\n", oldest_name.c_str(), (unsigned)(fsize / 1024));
                } else {
                    break;
                }
                used = SD.usedBytes();
                usage_pct = (int)(used * 100 / total);
            }
            if (rotated > 0) {
                Serial.printf("  💾 Rotated %d files, now %d%% used\n", rotated, usage_pct);
            }
        }
    }

    // Generate filename with NTP timestamp
    char filename[64];
    time_t now;
    struct tm timeinfo;
    time(&now);
    localtime_r(&now, &timeinfo);
    strftime(filename, sizeof(filename), "/rec_%Y%m%d_%H%M%S.avi", &timeinfo);

    recordingFile = SD.open(filename, FILE_WRITE);
    if (recordingFile) {
        // Initialize AVI writer with current resolution and configured fps
        sensor_t* s = esp_camera_sensor_get();
        uint16_t w = 640, h = 480; // VGA default
        if (s) {
            // Map framesize to pixels (VGA=640x480 is the common recording resolution)
            switch (s->status.framesize) {
                case FRAMESIZE_QVGA: w = 320; h = 240; break;
                case FRAMESIZE_VGA:  w = 640; h = 480; break;
                case FRAMESIZE_SVGA: w = 800; h = 600; break;
                case FRAMESIZE_XGA:  w = 1024; h = 768; break;
                default: w = 640; h = 480; break;
            }
        }
        int fps = config.sd_record_fps > 0 ? config.sd_record_fps : 10;
        if (!aviWriter.begin(recordingFile, w, h, fps, I2S_SAMPLE_RATE)) {
            Serial.println("❌ AVI header write failed");
            recordingFile.close();
            xSemaphoreGive(recordingMutex);
            return false;
        }

        strncpy(lastRecordingFilename, filename, sizeof(lastRecordingFilename) - 1);
        lastRecordingFilename[sizeof(lastRecordingFilename) - 1] = '\0';
        is_recording = true;
        Serial.printf("💾 AVI recording started: %s (%dx%d @%dfps)\n", filename, w, h, fps);
        xSemaphoreGive(recordingMutex);
        return true;
    }

    Serial.println("❌ Auto-recording: failed to open file");
    xSemaphoreGive(recordingMutex);
    return false;
}

void stopSDRecording() {
    if (!recordingMutex) return;
    if (!is_recording) return;

    if (xSemaphoreTake(recordingMutex, pdMS_TO_TICKS(500)) == pdTRUE) {
        is_recording = false;
        xSemaphoreGive(recordingMutex);
        // Wait for recordingTask to finish its current write
        vTaskDelay(pdMS_TO_TICKS(200));
        if (xSemaphoreTake(recordingMutex, pdMS_TO_TICKS(2000)) == pdTRUE) {
            aviWriter.end();
            recordingFile.close();
            Serial.printf("💾 AVI recording stopped: %u frames, %u audio chunks\n",
                aviWriter.getVideoFrames(), aviWriter.getAudioChunks());
            xSemaphoreGive(recordingMutex);
        }
    }
}

// --- SD Download Handler ---
static esp_err_t sd_download_handler(httpd_req_t *req) {
    set_cors_headers(req);

    if (!SD.cardSize()) {
        httpd_resp_send_err(req, HTTPD_404_NOT_FOUND, "No SD card");
        return ESP_FAIL;
    }

    // Parse ?file= query parameter
    char query[128] = {0};
    char filepath[96] = {0};
    if (httpd_req_get_url_query_str(req, query, sizeof(query)) != ESP_OK) {
        httpd_resp_send_err(req, HTTPD_400_BAD_REQUEST, "Missing ?file= parameter");
        return ESP_FAIL;
    }
    if (httpd_query_key_value(query, "file", filepath, sizeof(filepath)) != ESP_OK) {
        httpd_resp_send_err(req, HTTPD_400_BAD_REQUEST, "Missing file parameter");
        return ESP_FAIL;
    }

    // Security: prevent path traversal
    if (strstr(filepath, "..") != NULL) {
        httpd_resp_send_err(req, HTTPD_400_BAD_REQUEST, "Invalid path");
        return ESP_FAIL;
    }

    // Ensure path starts with /
    String path = filepath;
    if (!path.startsWith("/")) path = "/" + path;

    File file = SD.open(path, FILE_READ);
    if (!file || file.isDirectory()) {
        if (file) file.close();
        httpd_resp_send_err(req, HTTPD_404_NOT_FOUND, "File not found");
        return ESP_FAIL;
    }

    // Set content type based on extension
    if (path.endsWith(".jpg") || path.endsWith(".jpeg")) {
        httpd_resp_set_type(req, "image/jpeg");
    } else if (path.endsWith(".mjpeg")) {
        httpd_resp_set_type(req, "application/octet-stream");
    } else {
        httpd_resp_set_type(req, "application/octet-stream");
    }

    // Content-Disposition: attachment for download
    String disposition = "attachment; filename=\"" + path.substring(path.lastIndexOf('/') + 1) + "\"";
    httpd_resp_set_hdr(req, "Content-Disposition", disposition.c_str());

    // Stream file in 4KB chunks
    size_t total = file.size();
    char chunk[4096];
    size_t sent = 0;
    while (sent < total) {
        size_t to_read = (total - sent > sizeof(chunk)) ? sizeof(chunk) : (total - sent);
        size_t read = file.read((uint8_t*)chunk, to_read);
        if (read == 0) break;
        if (httpd_resp_send_chunk(req, chunk, read) != ESP_OK) {
            file.close();
            return ESP_FAIL;
        }
        sent += read;
        // Reset WDT for large files
        if (sent % (64 * 1024) == 0) esp_task_wdt_reset();
    }
    file.close();

    // End chunked response
    httpd_resp_send_chunk(req, NULL, 0);
    Serial.printf("💾 SD download: %s (%u KB)\n", path.c_str(), (unsigned)(total / 1024));
    return ESP_OK;
}

// Handler: SD Card — list files (GET) and clear all (POST)
static void deleteAllFiles(fs::FS &fs, const char *dirname, int &count) {
    // Loop until directory is empty (handles dirs with thousands of files)
    String dirStr = String(dirname);
    if (!dirStr.endsWith("/") && dirStr != "/") dirStr += "/";

    while (true) {
        File root = fs.open(dirname);
        if (!root || !root.isDirectory()) { root.close(); return; }

        File entry = root.openNextFile();
        if (!entry) { root.close(); return; } // Directory empty, done

        // Build full path: dirname + "/" + entry name
        // file.name() on ESP32 SD returns just the name (not full path)
        String name = String(entry.name());
        // Strip any leading path components — just keep the filename
        int lastSlash = name.lastIndexOf('/');
        if (lastSlash >= 0) name = name.substring(lastSlash + 1);
        String path = (dirStr == "/") ? "/" + name : dirStr + name;

        bool dir = entry.isDirectory();
        entry.close();
        root.close(); // Close dir before modifying (important for FAT)

        Serial.printf("  [%s] %s\n", dir ? "DIR" : "FILE", path.c_str());

        if (dir) {
            deleteAllFiles(fs, path.c_str(), count);
            if (!fs.rmdir(path.c_str())) {
                Serial.printf("  FAIL rmdir: %s (skipping)\n", path.c_str());
                return;
            }
        } else {
            if (fs.remove(path.c_str())) {
                count++;
                if (count % 200 == 0) Serial.printf("  🗑️ %d files deleted...\n", count);
            } else {
                Serial.printf("  FAIL rm: %s (skipping)\n", path.c_str());
                return;
            }
        }
    }
}

static esp_err_t sd_list_handler(httpd_req_t *req) {
    set_cors_headers(req);
    httpd_resp_set_type(req, "text/plain");

    if (!SD.cardSize()) {
        httpd_resp_send(req, "no_sd_card", HTTPD_RESP_USE_STRLEN);
        return ESP_OK;
    }

    File root = SD.open("/");
    if (!root) {
        httpd_resp_send(req, "cannot_open_root", HTTPD_RESP_USE_STRLEN);
        return ESP_OK;
    }

    String listing;
    File entry = root.openNextFile();
    int count = 0;
    while (entry && count < 200) {
        listing += entry.isDirectory() ? "[DIR] " : "";
        listing += String(entry.name());
        if (!entry.isDirectory()) {
            listing += " (" + String(entry.size() / 1024) + " KB)";
        }
        listing += "\n";
        entry.close();
        count++;
        entry = root.openNextFile();
    }
    root.close();

    if (listing.isEmpty()) listing = "(empty)\n";
    listing += "\nTotal: " + String(SD.usedBytes() / (1024*1024)) + " MB used / " +
               String(SD.totalBytes() / (1024*1024)) + " MB total\n";

    httpd_resp_send(req, listing.c_str(), HTTPD_RESP_USE_STRLEN);
    return ESP_OK;
}

static esp_err_t sd_clear_handler(httpd_req_t *req) {
    if (check_basic_auth(req) != ESP_OK) return ESP_FAIL;
    set_cors_headers(req);
    httpd_resp_set_type(req, "application/json");

    if (!SD.cardSize()) {
        httpd_resp_send(req, "{\"error\":\"no_sd_card\"}", HTTPD_RESP_USE_STRLEN);
        return ESP_OK;
    }

    Serial.println("🗑️ SD card clear requested...");
    uint64_t before = SD.usedBytes();
    int count = 0;
    deleteAllFiles(SD, "/", count);
    uint64_t after = SD.usedBytes();
    Serial.printf("🗑️ SD cleared: %d files, %llu MB freed\n", count, (before - after) / (1024 * 1024));

    char json[128];
    snprintf(json, sizeof(json), "{\"files_deleted\":%d,\"freed_mb\":%llu,\"remaining_mb\":%llu}",
             count, (before - after) / (1024 * 1024), after / (1024 * 1024));
    httpd_resp_send(req, json, HTTPD_RESP_USE_STRLEN);
    return ESP_OK;
}

// Handler: PSRAM Stats Endpoint (JSON)
static esp_err_t psram_stats_handler(httpd_req_t *req) {
    set_cors_headers(req);
    httpd_resp_set_type(req, "application/json");

    uint32_t psram_total = ESP.getPsramSize();
    uint32_t psram_free = ESP.getFreePsram();
    uint32_t psram_used = psram_total - psram_free;
    float usage_pct = (float)psram_used / psram_total * 100.0f;

    char json[256];
    snprintf(json, sizeof(json),
             "{\"total\":%u,\"free\":%u,\"used\":%u,\"usage_pct\":%.1f,"
             "\"total_mb\":%.2f,\"free_mb\":%.2f,\"used_mb\":%.2f}",
             psram_total,
             psram_free,
             psram_used,
             usage_pct,
             psram_total / 1024.0f / 1024.0f,
             psram_free / 1024.0f / 1024.0f,
             psram_used / 1024.0f / 1024.0f);

    httpd_resp_send(req, json, strlen(json));
    return ESP_OK;
}

// Init-time register readback (from main.cpp, stored before captureTask starts)
extern int initZone0_1;  // 0x5688 at init
extern int initZone8_9;  // 0x568c at init

// Handler: Health Check Endpoint (JSON)
// Debug: read OV3660 sensor registers (AEC, VTS, zone weights)
static esp_err_t reg_debug_handler(httpd_req_t *req) {
    httpd_resp_set_type(req, "application/json");
    httpd_resp_set_hdr(req, "Access-Control-Allow-Origin", "*");

    sensor_t* s = esp_camera_sensor_get();
    if (!s) {
        httpd_resp_sendstr(req, "{\"error\":\"no sensor\"}");
        return ESP_OK;
    }

    char buf[768];
    snprintf(buf, sizeof(buf),
        "{\"init_zone_0_1\":\"0x%02X (want 0x11)\",\"init_zone_8_9\":\"0x%02X (want 0xEE)\","
        "\"aec_target_hi\":\"0x3a0f=%d\",\"aec_target_lo\":\"0x3a10=%d\","
        "\"aec_actual_hi\":\"0x3a1b=%d\",\"aec_actual_lo\":\"0x3a1e=%d\","
        "\"vts_hi\":\"0x380e=0x%02X\",\"vts_lo\":\"0x380f=0x%02X\","
        "\"zone_0_1_runtime\":\"0x5688=0x%02X\",\"zone_2_3_runtime\":\"0x5689=0x%02X\","
        "\"zone_8_9_runtime\":\"0x568c=0x%02X\",\"zone_14_15_runtime\":\"0x568f=0x%02X\","
        "\"exposure_hi\":\"0x3500=0x%02X\",\"exposure_mid\":\"0x3501=0x%02X\","
        "\"exposure_lo\":\"0x3502=0x%02X\","
        "\"gain\":\"0x350a=0x%02X,0x350b=0x%02X\","
        "\"aec_ctrl\":\"0x3503=0x%02X\"}",
        initZone0_1, initZone8_9,
        s->get_reg(s, 0x3a0f, 0xff), s->get_reg(s, 0x3a10, 0xff),
        s->get_reg(s, 0x3a1b, 0xff), s->get_reg(s, 0x3a1e, 0xff),
        s->get_reg(s, 0x380e, 0xff), s->get_reg(s, 0x380f, 0xff),
        s->get_reg(s, 0x5688, 0xff), s->get_reg(s, 0x5689, 0xff),
        s->get_reg(s, 0x568c, 0xff), s->get_reg(s, 0x568f, 0xff),
        s->get_reg(s, 0x3500, 0xff), s->get_reg(s, 0x3501, 0xff),
        s->get_reg(s, 0x3502, 0xff),
        s->get_reg(s, 0x350a, 0xff), s->get_reg(s, 0x350b, 0xff),
        s->get_reg(s, 0x3503, 0xff));

    httpd_resp_sendstr(req, buf);
    return ESP_OK;
}

static esp_err_t health_handler(httpd_req_t *req) {
    esp_task_wdt_reset(); // Keep WDT happy in detection stream
    
    httpd_resp_set_type(req, "application/json");
    httpd_resp_set_hdr(req, "Access-Control-Allow-Origin", "*");
    
    // FIXED: Use StaticJsonDocument to avoid heap fragmentation
    StaticJsonDocument<1024> doc;
    
    // Uptime
    unsigned long uptimeSeconds = millis() / 1000;
    doc["uptime_seconds"] = uptimeSeconds;
    doc["uptime_hours"] = (uptimeSeconds % 86400) / 3600;
    doc["uptime_days"] = uptimeSeconds / 86400;
    
    // Memory
    doc["free_heap"] = ESP.getFreeHeap();
    doc["free_psram"] = ESP.getFreePsram();
    doc["heap_health"] = ESP.getFreeHeap() > 50000 ? "healthy" : 
                        (ESP.getFreeHeap() > 30000 ? "warning" : "critical");
    
    // WiFi
    if (WiFi.status() == WL_CONNECTED) {
        doc["wifi_connected"] = true;
        doc["wifi_rssi"] = WiFi.RSSI();
        doc["wifi_quality"] = getWiFiQuality(WiFi.RSSI());
        doc["wifi_reconnects_1h"] = wifi_health.reconnect_count;
    } else {
        doc["wifi_connected"] = false;
        doc["wifi_quality"] = "disconnected";
    }
    
    // System Stats
    doc["total_restarts"] = sys_stats.total_restarts;
    doc["last_restart_reason"] = sys_stats.last_restart_reason;
    
    // Overall health status
    bool healthy = true;
    String issues = "";
    
    if (ESP.getFreeHeap() < 50000) {
        healthy = false;
        issues += "low_memory,";
    }
    if (WiFi.RSSI() < -75) {
        healthy = false;
        issues += "weak_wifi,";
    }
    if (wifi_health.reconnect_count > 3) {
        healthy = false;
        issues += "unstable_wifi,";
    }
    
    doc["overall_health"] = healthy ? "healthy" : "degraded";
    doc["issues"] = issues.length() > 0 ? issues.substring(0, issues.length()-1) : "none";
    doc["status"] = healthy ? "ok" : "warning";
    
    String response;
    serializeJson(doc, response);
    httpd_resp_sendstr(req, response.c_str());
    return ESP_OK;
}

// --- Captive Portal WiFi Setup ---
// Shown in AP mode when user connects and opens any URL
const char CAPTIVE_PORTAL_HTML[] PROGMEM = R"rawliteral(
<!DOCTYPE html>
<html lang="cs">
<head>
    <meta charset="UTF-8">
    <title>ESP32 WiFi Setup</title>
    <meta name="viewport" content="width=device-width, initial-scale=1">
    <style>
        *{margin:0;padding:0;box-sizing:border-box}
        body{font-family:Arial,sans-serif;background:#1a1a2e;min-height:100vh;display:flex;justify-content:center;align-items:center;padding:20px}
        .card{background:#fff;border-radius:16px;box-shadow:0 10px 40px rgba(0,0,0,.4);max-width:400px;width:100%;overflow:hidden}
        .header{background:linear-gradient(135deg,#667eea,#764ba2);color:#fff;padding:24px;text-align:center}
        .header h1{font-size:1.4em;margin-bottom:6px}
        .header p{opacity:.85;font-size:.85em}
        .form{padding:24px}
        .field{margin-bottom:16px}
        .field label{display:block;margin-bottom:6px;font-weight:bold;color:#333;font-size:.9em}
        .field input{width:100%;padding:12px;border:2px solid #ddd;border-radius:8px;font-size:1em}
        .field input:focus{outline:none;border-color:#667eea}
        .btn{width:100%;padding:14px;border:none;border-radius:10px;font-size:1.1em;cursor:pointer;color:#fff;background:linear-gradient(135deg,#667eea,#764ba2);margin-top:8px}
        .btn:hover{transform:translateY(-1px);box-shadow:0 4px 12px rgba(0,0,0,.3)}
        .msg{padding:12px;border-radius:8px;margin-bottom:16px;display:none;text-align:center}
        .msg.ok{background:#d4edda;color:#155724;display:block}
        .msg.err{background:#f8d7da;color:#721c24;display:block}
        .scan{color:#667eea;cursor:pointer;font-size:.85em;text-decoration:underline;margin-bottom:12px;display:inline-block}
        #networks{margin-bottom:12px}
        #networks div{padding:8px 12px;background:#f5f5f5;border-radius:6px;margin:4px 0;cursor:pointer;font-size:.9em}
        #networks div:hover{background:#e0e0ff}
    </style>
</head>
<body>
    <div class="card">
        <div class="header">
            <h1>📷 ESP32-S3 AI Kamera</h1>
            <p>Nastaveni WiFi pripojeni</p>
        </div>
        <div class="form">
            <div id="status" class="msg"></div>
            <span class="scan" onclick="scanNetworks()">🔍 Hledat WiFi site</span>
            <div id="networks"></div>
            <form id="wifiForm" onsubmit="return submitForm(event)">
                <div class="field">
                    <label for="ssid">WiFi SSID</label>
                    <input type="text" id="ssid" name="ssid" required placeholder="Nazev WiFi site">
                </div>
                <div class="field">
                    <label for="pass">WiFi heslo</label>
                    <input type="password" id="pass" name="pass" placeholder="Heslo">
                </div>
                <button type="submit" class="btn">📡 Pripojit</button>
            </form>
        </div>
    </div>
    <script>
        function scanNetworks(){
            document.getElementById('networks').innerHTML='<div>Hledam...</div>';
            fetch('/wifi-scan').then(r=>r.json()).then(data=>{
                var h='';
                data.forEach(n=>{h+='<div onclick="document.getElementById(\'ssid\').value=\''+n.ssid+'\'">'+n.ssid+' ('+n.rssi+' dBm)</div>'});
                document.getElementById('networks').innerHTML=h||'<div>Zadne site nenalezeny</div>';
            }).catch(()=>{document.getElementById('networks').innerHTML='<div>Chyba skenovani</div>'});
        }
        function submitForm(e){
            e.preventDefault();
            var s=document.getElementById('status');
            s.className='msg ok';s.textContent='Ukladam... ESP32 se restartuje.';s.style.display='block';
            fetch('/wifi-save',{method:'POST',headers:{'Content-Type':'application/json'},
                body:JSON.stringify({ssid:document.getElementById('ssid').value,password:document.getElementById('pass').value})
            }).then(r=>r.json()).then(()=>{
                s.textContent='Ulozeno! ESP32 se restartuje za 3s...';
            }).catch(()=>{s.className='msg err';s.textContent='Chyba ukladani';});
            return false;
        }
    </script>
</body>
</html>
)rawliteral";

// Handler: Captive portal setup page
static esp_err_t captive_portal_handler(httpd_req_t *req) {
    httpd_resp_set_type(req, "text/html");
    return httpd_resp_send(req, CAPTIVE_PORTAL_HTML, HTTPD_RESP_USE_STRLEN);
}

// Handler: WiFi network scan
static esp_err_t wifi_scan_handler(httpd_req_t *req) {
    httpd_resp_set_type(req, "application/json");
    httpd_resp_set_hdr(req, "Access-Control-Allow-Origin", "*");

    int n = WiFi.scanNetworks(false, false, false, 300);
    String json = "[";
    for (int i = 0; i < n && i < 15; i++) {
        if (i > 0) json += ",";
        json += "{\"ssid\":\"" + WiFi.SSID(i) + "\",\"rssi\":" + String(WiFi.RSSI(i)) + "}";
    }
    json += "]";
    WiFi.scanDelete();

    return httpd_resp_sendstr(req, json.c_str());
}

// Handler: Save WiFi credentials and reboot
static esp_err_t wifi_save_handler(httpd_req_t *req) {
    httpd_resp_set_type(req, "application/json");
    httpd_resp_set_hdr(req, "Access-Control-Allow-Origin", "*");

    char buf[512];
    int received = httpd_req_recv(req, buf, sizeof(buf) - 1);
    if (received <= 0) {
        httpd_resp_send_err(req, HTTPD_400_BAD_REQUEST, "No body");
        return ESP_FAIL;
    }
    buf[received] = '\0';

    StaticJsonDocument<256> doc;
    DeserializationError err = deserializeJson(doc, buf);
    if (err || !doc.containsKey("ssid")) {
        httpd_resp_send_err(req, HTTPD_400_BAD_REQUEST, "Invalid JSON");
        return ESP_FAIL;
    }

    config.wifi_ssid = doc["ssid"].as<String>();
    config.wifi_password = doc["password"] | "";
    saveCredentialsToNVS();

    httpd_resp_sendstr(req, "{\"ok\":true}");
    Serial.printf("✅ WiFi credentials saved via captive portal: SSID=%s\n", config.wifi_ssid.c_str());

    // Delayed restart to let HTTP response complete
    vTaskDelay(pdMS_TO_TICKS(3000));
    ESP.restart();
    return ESP_OK;  // unreachable
}

// Handler: Redirect any unknown URL to captive portal (AP mode)
static esp_err_t captive_redirect_handler(httpd_req_t *req) {
    String url = "http://" + WiFi.softAPIP().toString() + "/setup";
    httpd_resp_set_status(req, "302 Found");
    httpd_resp_set_hdr(req, "Location", url.c_str());
    return httpd_resp_send(req, NULL, 0);
}

// --- Credentials Endpoint ---
// GET /credentials — returns masked overview (no passwords visible)
static esp_err_t credentials_get_handler(httpd_req_t *req) {
    if (check_basic_auth(req) != ESP_OK) return ESP_FAIL;

    httpd_resp_set_type(req, "application/json");
    httpd_resp_set_hdr(req, "Access-Control-Allow-Origin", "*");

    StaticJsonDocument<512> doc;
    doc["wifi_ssid"] = config.wifi_ssid;
    doc["wifi_pass_set"] = config.wifi_password.length() > 0;
    doc["telegram_token_set"] = config.telegram_bot_token.length() > 0;
    doc["telegram_chat_id"] = config.telegram_chat_id;
    doc["http_user"] = config.http_user;
    doc["http_pass_set"] = config.http_pass.length() > 0;
    doc["ota_pass_set"] = config.ota_password.length() > 0;
    doc["ap_pass_set"] = config.ap_password.length() > 0;
    doc["mqtt_user"] = config.mqtt_user;
    doc["mqtt_pass_set"] = config.mqtt_pass.length() > 0;

    String response;
    serializeJson(doc, response);
    httpd_resp_sendstr(req, response.c_str());
    return ESP_OK;
}

// POST /credentials — update credentials and save to NVS
// Only fields present in JSON body are updated
static esp_err_t credentials_post_handler(httpd_req_t *req) {
    if (check_basic_auth(req) != ESP_OK) return ESP_FAIL;

    httpd_resp_set_type(req, "application/json");
    httpd_resp_set_hdr(req, "Access-Control-Allow-Origin", "*");

    char buf[1024];
    int received = httpd_req_recv(req, buf, sizeof(buf) - 1);
    if (received <= 0) {
        httpd_resp_send_err(req, HTTPD_400_BAD_REQUEST, "No body");
        return ESP_FAIL;
    }
    buf[received] = '\0';

    StaticJsonDocument<1024> doc;
    DeserializationError err = deserializeJson(doc, buf);
    if (err) {
        httpd_resp_send_err(req, HTTPD_400_BAD_REQUEST, "Invalid JSON");
        return ESP_FAIL;
    }

    bool restart_required = false;

    if (doc.containsKey("wifi_ssid")) {
        config.wifi_ssid = doc["wifi_ssid"].as<String>();
        restart_required = true;
    }
    if (doc.containsKey("wifi_password")) {
        config.wifi_password = doc["wifi_password"].as<String>();
        restart_required = true;
    }
    if (doc.containsKey("telegram_bot_token")) {
        config.telegram_bot_token = doc["telegram_bot_token"].as<String>();
    }
    if (doc.containsKey("telegram_chat_id")) {
        config.telegram_chat_id = doc["telegram_chat_id"].as<String>();
    }
    if (doc.containsKey("http_user")) {
        config.http_user = doc["http_user"].as<String>();
    }
    if (doc.containsKey("http_pass")) {
        config.http_pass = doc["http_pass"].as<String>();
    }
    if (doc.containsKey("ota_password")) {
        config.ota_password = doc["ota_password"].as<String>();
        restart_required = true;
    }
    if (doc.containsKey("ap_password")) {
        config.ap_password = doc["ap_password"].as<String>();
        restart_required = true;
    }
    if (doc.containsKey("mqtt_user")) {
        config.mqtt_user = doc["mqtt_user"].as<String>();
        restart_required = true;
    }
    if (doc.containsKey("mqtt_pass")) {
        config.mqtt_pass = doc["mqtt_pass"].as<String>();
        restart_required = true;
    }

    saveCredentialsToNVS();

    StaticJsonDocument<128> resp;
    resp["ok"] = true;
    resp["restart_required"] = restart_required;

    String response;
    serializeJson(resp, response);
    httpd_resp_sendstr(req, response.c_str());
    Serial.println("Credentials updated via /credentials POST");
    return ESP_OK;
}

// HTTP OTA Update handler — POST /update with raw firmware binary body
static esp_err_t ota_update_handler(httpd_req_t *req) {
    if (check_basic_auth(req) != ESP_OK) return ESP_FAIL;

    Serial.printf("OTA: Receiving firmware (%d bytes)...\n", req->content_len);

    if (req->content_len <= 0 || req->content_len > 6000000) {
        httpd_resp_send_err(req, HTTPD_400_BAD_REQUEST, "Invalid firmware size");
        return ESP_FAIL;
    }

    // Suspend camera capture to free memory and prevent crashes
    if (captureTaskHandle) {
        vTaskSuspend(captureTaskHandle);
        Serial.println("OTA: Camera capture suspended");
    }

    if (!Update.begin(req->content_len)) {
        Serial.printf("OTA: Update.begin failed: %s\n", Update.errorString());
        if (captureTaskHandle) vTaskResume(captureTaskHandle);
        httpd_resp_send_err(req, HTTPD_500_INTERNAL_SERVER_ERROR, "OTA begin failed");
        return ESP_FAIL;
    }

    // Read and write firmware in chunks
    char buf[4096];
    int remaining = req->content_len;
    int written = 0;

    while (remaining > 0) {
        int recv_len = httpd_req_recv(req, buf, (remaining < sizeof(buf)) ? remaining : sizeof(buf));
        if (recv_len <= 0) {
            if (recv_len == HTTPD_SOCK_ERR_TIMEOUT) continue;
            Serial.println("OTA: Receive error");
            Update.abort();
            if (captureTaskHandle) vTaskResume(captureTaskHandle);
            httpd_resp_send_err(req, HTTPD_500_INTERNAL_SERVER_ERROR, "Receive error");
            return ESP_FAIL;
        }

        if (Update.write((uint8_t*)buf, recv_len) != recv_len) {
            Serial.printf("OTA: Write error: %s\n", Update.errorString());
            Update.abort();
            if (captureTaskHandle) vTaskResume(captureTaskHandle);
            httpd_resp_send_err(req, HTTPD_500_INTERNAL_SERVER_ERROR, "Write error");
            return ESP_FAIL;
        }

        remaining -= recv_len;
        written += recv_len;

        // Progress every 10%
        if (written % (req->content_len / 10 + 1) < recv_len) {
            Serial.printf("OTA: %d%% (%d/%d bytes)\n", written * 100 / req->content_len, written, req->content_len);
            esp_task_wdt_reset();
        }
    }

    if (!Update.end(true)) {
        Serial.printf("OTA: Finalize error: %s\n", Update.errorString());
        if (captureTaskHandle) vTaskResume(captureTaskHandle);
        httpd_resp_send_err(req, HTTPD_500_INTERNAL_SERVER_ERROR, "OTA finalize failed");
        return ESP_FAIL;
    }

    Serial.println("OTA: Update successful! Rebooting...");
    httpd_resp_set_type(req, "application/json");
    httpd_resp_sendstr(req, "{\"ok\":true,\"message\":\"Update successful, rebooting...\"}");

    vTaskDelay(pdMS_TO_TICKS(500));
    ESP.restart();
    return ESP_OK;
}

// --- Handler registration helpers (reduce startCameraServer size) ---

// Helper: register GET + OPTIONS pair for an endpoint
static void registerGetEndpoint(httpd_handle_t server, const char* uri,
                                 esp_err_t (*handler)(httpd_req_t*)) {
    httpd_uri_t get_uri = { .uri = uri, .method = HTTP_GET, .handler = handler, .user_ctx = NULL };
    httpd_uri_t opt_uri = { .uri = uri, .method = HTTP_OPTIONS, .handler = options_handler, .user_ctx = NULL };
    httpd_register_uri_handler(server, &get_uri);
    httpd_register_uri_handler(server, &opt_uri);
}

// Helper: register POST + OPTIONS pair
static void registerPostEndpoint(httpd_handle_t server, const char* uri,
                                  esp_err_t (*handler)(httpd_req_t*)) {
    httpd_uri_t post_uri = { .uri = uri, .method = HTTP_POST, .handler = handler, .user_ctx = NULL };
    httpd_uri_t opt_uri = { .uri = uri, .method = HTTP_OPTIONS, .handler = options_handler, .user_ctx = NULL };
    httpd_register_uri_handler(server, &post_uri);
    httpd_register_uri_handler(server, &opt_uri);
}

// Helper: register GET + POST + OPTIONS triple
static void registerCrudEndpoint(httpd_handle_t server, const char* uri,
                                  esp_err_t (*get_handler)(httpd_req_t*),
                                  esp_err_t (*post_handler)(httpd_req_t*)) {
    httpd_uri_t get_uri = { .uri = uri, .method = HTTP_GET, .handler = get_handler, .user_ctx = NULL };
    httpd_uri_t post_uri = { .uri = uri, .method = HTTP_POST, .handler = post_handler, .user_ctx = NULL };
    httpd_uri_t opt_uri = { .uri = uri, .method = HTTP_OPTIONS, .handler = options_handler, .user_ctx = NULL };
    httpd_register_uri_handler(server, &get_uri);
    httpd_register_uri_handler(server, &post_uri);
    httpd_register_uri_handler(server, &opt_uri);
}

void startCameraServer() {
    // Initialize SD Card (SPI mode — DFRobot FireBeetle2 DFR1154)
    // CS pin must be HIGH before SPI init (DFRobot example pattern)
    pinMode(SD_CARD_CS, OUTPUT);
    digitalWrite(SD_CARD_CS, HIGH);
    SPI.begin(SD_CARD_SCK, SD_CARD_MISO, SD_CARD_MOSI);
    SPI.setFrequency(1000000);  // 1MHz for reliable init
    if(!SD.begin(SD_CARD_CS, SPI, 4000000)) {
        Serial.println("❌ SD Card Mount Failed at 4MHz, retrying 1MHz...");
        if(!SD.begin(SD_CARD_CS, SPI, 1000000)) {
            Serial.println("❌ SD Card Mount Failed (no card or wiring issue)");
        }
    }
    if(SD.cardType() != CARD_NONE && SD.cardSize() > 0) {
        Serial.printf("✅ SD Card Mounted: %llu MB\n", SD.cardSize() / (1024 * 1024));
    }

    httpd_config_t http_config = HTTPD_DEFAULT_CONFIG();
    http_config.server_port = 80;
    http_config.ctrl_port = 32768;
    http_config.max_open_sockets = 3;         // REDUCED to save sockets (was 7)
    http_config.lru_purge_enable = true;      // Auto-close oldest socket when limit reached
    http_config.stack_size = 20480;           // FIXED: Increased from 16KB to 20KB to prevent stack overflow
    http_config.max_uri_handlers = 46;        // 43 handlers + reserve

    httpd_config_t stream_config = HTTPD_DEFAULT_CONFIG();
    stream_config.server_port = 81;
    stream_config.ctrl_port = 32769;
    stream_config.max_open_sockets = 2;       // REDUCED (was 4) - Only 2 active streams allowed
    stream_config.lru_purge_enable = true;
    stream_config.stack_size = 20480;         // FIXED: Increased from 16KB to 20KB to prevent stack overflow
    stream_config.max_uri_handlers = 10;

    httpd_config_t audio_config = HTTPD_DEFAULT_CONFIG();
    audio_config.server_port = 82;
    audio_config.ctrl_port = 32770;
    audio_config.max_open_sockets = 2;        // REDUCED (was 4)
    audio_config.lru_purge_enable = true;
    audio_config.stack_size = 8192;           // Audio handler is simpler
    audio_config.max_uri_handlers = 5;

    Serial.println("🔧 Configuring HTTP servers...");

    // Initialize UDP Mutex
    if (udp_mutex == NULL) {
        udp_mutex = xSemaphoreCreateMutex();
        if (udp_mutex == NULL) {
             Serial.println("❌ Failed to create UDP mutex!");
        } else {
             Serial.println("✅ UDP mutex created");
        }
    }

    // Initialize recording mutex
    if (recordingMutex == NULL) {
        recordingMutex = xSemaphoreCreateMutex();
        if (recordingMutex == NULL) {
            Serial.println("❌ Failed to create recording mutex!");
        } else {
            Serial.println("✅ Recording mutex created");
        }
    }

    // FIXED: Initialize settings mutex (thread-safe) - NO configASSERT to avoid restart!
    if (settings_mutex == NULL) {
        settings_mutex = xSemaphoreCreateMutex();
        if (settings_mutex == NULL) {
            Serial.println("❌ Failed to create settings mutex!");
            // Don't restart - better to continue without mutex than restart loop
        } else {
            Serial.println("✅ Settings mutex created");
        }
    }

    // URI handlers
    httpd_uri_t index_uri = {
        .uri       = "/",
        .method    = HTTP_GET,
        .handler   = index_handler,
        .user_ctx  = NULL
    };
    httpd_uri_t index_options_uri = {
        .uri       = "/",
        .method    = HTTP_OPTIONS,
        .handler   = options_handler,
        .user_ctx  = NULL
    };

    httpd_uri_t frame_uri = {
        .uri       = "/frame",
        .method    = HTTP_GET,
        .handler   = frame_handler,
        .user_ctx  = NULL
    };
    httpd_uri_t frame_options_uri = {
        .uri       = "/frame",
        .method    = HTTP_OPTIONS,
        .handler   = options_handler,
        .user_ctx  = NULL
    };

    httpd_uri_t stream_uri = {
        .uri       = "/stream",
        .method    = HTTP_GET,
        .handler   = stream_handler,
        .user_ctx  = NULL
    };
    httpd_uri_t stream_options_uri = {
        .uri       = "/stream",
        .method    = HTTP_OPTIONS,
        .handler   = options_handler,
        .user_ctx  = NULL
    };
    httpd_uri_t stream_head_uri = {
        .uri       = "/stream",
        .method    = HTTP_HEAD,
        .handler   = stream_head_handler,
        .user_ctx  = NULL
    };

    httpd_uri_t detection_stream_uri = {
        .uri       = "/detection-stream",
        .method    = HTTP_GET,
        .handler   = detection_stream_handler,
        .user_ctx  = NULL
    };
    httpd_uri_t detection_stream_options_uri = {
        .uri       = "/detection-stream",
        .method    = HTTP_OPTIONS,
        .handler   = options_handler,
        .user_ctx  = NULL
    };
    httpd_uri_t detection_stream_head_uri = {
        .uri       = "/detection-stream",
        .method    = HTTP_HEAD,
        .handler   = stream_head_handler,
        .user_ctx  = NULL
    };

    httpd_uri_t status_uri = {
        .uri       = "/status",
        .method    = HTTP_GET,
        .handler   = status_handler,
        .user_ctx  = NULL
    };
    httpd_uri_t status_options_uri = {
        .uri       = "/status",
        .method    = HTTP_OPTIONS,
        .handler   = options_handler,
        .user_ctx  = NULL
    };

    httpd_uri_t motion_status_uri = {
        .uri       = "/motion-status",
        .method    = HTTP_GET,
        .handler   = motion_status_handler,
        .user_ctx  = NULL
    };
    httpd_uri_t motion_status_options_uri = {
        .uri       = "/motion-status",
        .method    = HTTP_OPTIONS,
        .handler   = options_handler,
        .user_ctx  = NULL
    };

    httpd_uri_t settings_page_uri = {
        .uri       = "/settings-page",
        .method    = HTTP_GET,
        .handler   = settings_page_handler,
        .user_ctx  = NULL
    };
    httpd_uri_t settings_get_uri = {
        .uri       = "/settings",
        .method    = HTTP_GET,
        .handler   = settings_get_handler,
        .user_ctx  = NULL
    };
    httpd_uri_t settings_post_uri = {
        .uri       = "/settings",
        .method    = HTTP_POST,
        .handler   = settings_post_handler,
        .user_ctx  = NULL
    };
    httpd_uri_t settings_options_uri = {
        .uri       = "/settings",
        .method    = HTTP_OPTIONS,
        .handler   = options_handler,
        .user_ctx  = NULL
    };

    httpd_uri_t ir_status_uri = {
        .uri       = "/ir-status",
        .method    = HTTP_GET,
        .handler   = ir_status_handler,
        .user_ctx  = NULL
    };
    httpd_uri_t ir_status_options_uri = {
        .uri       = "/ir-status",
        .method    = HTTP_OPTIONS,
        .handler   = options_handler,
        .user_ctx  = NULL
    };

    httpd_uri_t ir_control_uri = {
        .uri       = "/ir-control",
        .method    = HTTP_POST,
        .handler   = ir_control_handler,
        .user_ctx  = NULL
    };
    httpd_uri_t ir_control_options_uri = {
        .uri       = "/ir-control",
        .method    = HTTP_OPTIONS,
        .handler   = options_handler,
        .user_ctx  = NULL
    };

    // Audio status endpoint
    httpd_uri_t audio_status_uri = {
        .uri       = "/audio-status",
        .method    = HTTP_GET,
        .handler   = audio_status_handler,
        .user_ctx  = NULL
    };
    httpd_uri_t audio_status_options_uri = {
        .uri       = "/audio-status",
        .method    = HTTP_OPTIONS,
        .handler   = options_handler,
        .user_ctx  = NULL
    };

    // Stream stats endpoint
    httpd_uri_t stream_stats_uri = {
        .uri       = "/stream-stats",
        .method    = HTTP_GET,
        .handler   = stream_stats_handler,
        .user_ctx  = NULL
    };
    httpd_uri_t stream_stats_options_uri = {
        .uri       = "/stream-stats",
        .method    = HTTP_OPTIONS,
        .handler   = options_handler,
        .user_ctx  = NULL
    };

    // Audio stream endpoint (Port 81)
    httpd_uri_t audio_stream_uri = {
        .uri       = "/audio.wav",
        .method    = HTTP_GET,
        .handler   = audioStreamHandler,
        .user_ctx  = NULL
    };
    httpd_uri_t audio_stream_options_uri = {
        .uri       = "/audio.wav",
        .method    = HTTP_OPTIONS,
        .handler   = options_handler,
        .user_ctx  = NULL
    };

    httpd_uri_t reg_debug_uri = {
        .uri       = "/reg-debug",
        .method    = HTTP_GET,
        .handler   = reg_debug_handler,
        .user_ctx  = NULL
    };
    httpd_uri_t health_uri = {
        .uri       = "/health",
        .method    = HTTP_GET,
        .handler   = health_handler,
        .user_ctx  = NULL
    };
    httpd_uri_t health_options_uri = {
        .uri       = "/health",
        .method    = HTTP_OPTIONS,
        .handler   = options_handler,
        .user_ctx  = NULL
    };

    httpd_uri_t psram_stats_uri = {
        .uri       = "/psram-stats",
        .method    = HTTP_GET,
        .handler   = psram_stats_handler,
        .user_ctx  = NULL
    };
    httpd_uri_t psram_stats_options_uri = {
        .uri       = "/psram-stats",
        .method    = HTTP_OPTIONS,
        .handler   = options_handler,
        .user_ctx  = NULL
    };


    Serial.println("Starting camera web server (Port 80)...");

    if (httpd_start(&camera_httpd, &http_config) == ESP_OK) {
        // --- Core endpoints ---
        httpd_register_uri_handler(camera_httpd, &index_uri);
        httpd_register_uri_handler(camera_httpd, &index_options_uri);
        registerGetEndpoint(camera_httpd, "/frame", frame_handler);
        registerGetEndpoint(camera_httpd, "/status", status_handler);
        registerGetEndpoint(camera_httpd, "/health", health_handler);
        registerGetEndpoint(camera_httpd, "/psram-stats", psram_stats_handler);
        registerGetEndpoint(camera_httpd, "/stream-stats", stream_stats_handler);
        registerGetEndpoint(camera_httpd, "/motion-status", motion_status_handler);

        // Telemetry & debug
        httpd_uri_t reg_debug = { .uri = "/reg-debug", .method = HTTP_GET, .handler = reg_debug_handler, .user_ctx = NULL };
        httpd_register_uri_handler(camera_httpd, &reg_debug);
        httpd_uri_t telemetry = { .uri = "/telemetry", .method = HTTP_GET, .handler = telemetry_handler, .user_ctx = NULL };
        httpd_register_uri_handler(camera_httpd, &telemetry);

        // --- Settings ---
        httpd_register_uri_handler(camera_httpd, &settings_page_uri);
        registerCrudEndpoint(camera_httpd, "/settings", settings_get_handler, settings_post_handler);

        // --- IR control ---
        registerGetEndpoint(camera_httpd, "/ir-status", ir_status_handler);
        registerPostEndpoint(camera_httpd, "/ir-control", ir_control_handler);

        // --- Audio ---
        registerGetEndpoint(camera_httpd, "/audio-status", audio_status_handler);

        // --- Credentials & OTA ---
        registerCrudEndpoint(camera_httpd, "/credentials", credentials_get_handler, credentials_post_handler);
        registerPostEndpoint(camera_httpd, "/update", ota_update_handler);

        // --- Record ---
        httpd_uri_t record = { .uri = "/record", .method = HTTP_POST, .handler = record_handler, .user_ctx = NULL };
        httpd_register_uri_handler(camera_httpd, &record);

        // --- Captive portal (AP mode) ---
        httpd_uri_t setup_uri = { .uri = "/setup", .method = HTTP_GET, .handler = captive_portal_handler, .user_ctx = NULL };
        httpd_uri_t wifi_scan = { .uri = "/wifi-scan", .method = HTTP_GET, .handler = wifi_scan_handler, .user_ctx = NULL };
        httpd_register_uri_handler(camera_httpd, &setup_uri);
        httpd_register_uri_handler(camera_httpd, &wifi_scan);
        registerPostEndpoint(camera_httpd, "/wifi-save", wifi_save_handler);

        // Captive portal redirects
        httpd_uri_t gen204 = { .uri = "/generate_204", .method = HTTP_GET, .handler = captive_redirect_handler, .user_ctx = NULL };
        httpd_uri_t hotspot = { .uri = "/hotspot-detect.html", .method = HTTP_GET, .handler = captive_redirect_handler, .user_ctx = NULL };
        httpd_register_uri_handler(camera_httpd, &gen204);
        httpd_register_uri_handler(camera_httpd, &hotspot);

        // Live log endpoints
        wsLogRegisterHandlers(camera_httpd);

        Serial.println("All HTTP handlers registered");

    // Start Stream Server (Port 81)
    Serial.println("Starting stream server (Port 81)...");
    if (httpd_start(&stream_httpd, &stream_config) == ESP_OK) {
        httpd_register_uri_handler(stream_httpd, &stream_uri);
        httpd_register_uri_handler(stream_httpd, &stream_options_uri);
        httpd_register_uri_handler(stream_httpd, &stream_head_uri);
        
        httpd_register_uri_handler(stream_httpd, &detection_stream_uri);
        httpd_register_uri_handler(stream_httpd, &detection_stream_options_uri);
        httpd_register_uri_handler(stream_httpd, &detection_stream_head_uri);
        
        Serial.println("✅ Stream server started successfully");
    } else {
        Serial.println("❌ Failed to start stream server");
    }

#ifndef LITE_MODE_NO_RUNTIME_TASKS
    // Start Audio Server (Port 82)
    Serial.println("Starting audio server (Port 82)...");
    if (httpd_start(&audio_httpd, &audio_config) == ESP_OK) {
        httpd_register_uri_handler(audio_httpd, &audio_stream_uri);
        httpd_register_uri_handler(audio_httpd, &audio_stream_options_uri);
    }

    // Start RTSP Server
    Serial.println("Starting RTSP server...");
    if (rtspServer.init()) {
        Serial.printf("✅ RTSP server started at rtsp://%s:554/mjpeg/1\n", WiFi.localIP().toString().c_str());
    } else {
        Serial.println("❌ Failed to start RTSP server");
    }
#else
    Serial.println("⚡ LITE_MODE: audio_httpd:82 (~8KB) + RTSP (~16KB) skipped");
#endif

    // Start Central Camera Capture Task (feeds both RTSP and MJPEG)
    Serial.println("Starting Camera Capture Task...");
    startCameraCaptureTask();

        // Initialize motion detector
        // Moved to camera_capture.cpp (startCameraCaptureTask) to run in capture task context



        // --- Media & SD endpoints ---
        registerPostEndpoint(camera_httpd, "/save_frame", save_frame_handler);
        registerCrudEndpoint(camera_httpd, "/roi-mask", roi_mask_get_handler, roi_mask_post_handler);
        httpd_uri_t motion_debug = { .uri = "/motion-debug", .method = HTTP_GET, .handler = motion_debug_handler, .user_ctx = NULL };
        httpd_register_uri_handler(camera_httpd, &motion_debug);

        // SD card management
        httpd_uri_t sd_list = { .uri = "/sd-list", .method = HTTP_GET, .handler = sd_list_handler, .user_ctx = NULL };
        httpd_uri_t sd_dl = { .uri = "/sd-download", .method = HTTP_GET, .handler = sd_download_handler, .user_ctx = NULL };
        httpd_register_uri_handler(camera_httpd, &sd_list);
        httpd_register_uri_handler(camera_httpd, &sd_dl);
        registerPostEndpoint(camera_httpd, "/sd-clear", sd_clear_handler);

        Serial.println("Camera web server started successfully");

#ifndef LITE_MODE_NO_RUNTIME_TASKS
        // Start Recording Task (AVI with audio — needs extra stack for PCM buffer)
        xTaskCreatePinnedToCore(
            recordingTask,     // Task function
            "Recording",       // Task name
            6144,              // Stack size (3.2KB audio buffer on stack)
            NULL,              // Parameters
            1,                 // Priority (Low)
            NULL,              // Task handle
            1                  // Core 1 (same as capture to avoid cache thrashing?) or 0
        );
        Serial.println("✅ Recording task queued");
#else
        Serial.println("⚡ LITE_MODE: recording task skipped (~6KB stack)");
#endif
    } else {
        Serial.println("Failed to start camera web server");
    }
}
